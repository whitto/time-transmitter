#include "../firmware/RadioClock_V4_5/CasioBxProtocol.h"

#include <algorithm>
#include <array>
#include <cstdlib>
#include <iostream>
#include <string>
#include <vector>

static void require(bool value, const char* expression, int line) {
  if (!value) {
    std::cerr << "FAIL line " << line << ": " << expression << '\n';
    std::abort();
  }
}
#define CHECK(expression) require((expression), #expression, __LINE__)

using namespace CasioBxProtocol;
using Bytes = std::vector<uint8_t>;

static Bytes hex(const char* encoded) {
  const std::string text(encoded);
  CHECK(text.size() % 2 == 0);
  Bytes result;
  for (size_t index = 0; index < text.size(); index += 2) {
    result.push_back(static_cast<uint8_t>(std::stoul(text.substr(index, 2), nullptr, 16)));
  }
  return result;
}

// Fixtures are fixed packet bytes, not generated by the builders under test.
// Official-app capture btsnoop_hci_bx.log at commit
// ae817310dd9551d5e6e53ee61d89af4e8d954767 in izivkov/gshock_api:
// https://github.com/izivkov/gshock_api/blob/ae817310dd9551d5e6e53ee61d89af4e8d954767/test_data/btsnoop_hci_bx.log
// Notification records 1229, 1236, 1248; write record 1237 supplies the literal
// expected DST packet. The settings expectation preserves the watch's final
// eight bytes of its second 1D record; the app changes two of those to FF for
// an unknown purpose that this time-only implementation does not reproduce.
static const Bytes settingsReply = hex(
    "050f001d00010606e9760000ffffffffffff0f001d0203020019010000ffffffffffff"
    "14002400014044ba36ef8055fc4002007372be637d04"
    "14002401010000000000000000000000000000000000"
    "14002402010000000000000000000000000000000002");
static const Bytes settingsWrite = hex(
    "020f001d00010606e9760000ffffffffffff0f001d0203020019010000ffffffffffff");
static const Bytes cities = hex(
    "14002400014044ba36ef8055fc4002007372be637d04"
    "14002401010000000000000000000000000000000000"
    "14002402010000000000000000000000000000000002");
static const Bytes dstReply = hex(
    "0307001e00e97604040207001e01000000000007001e021901240400");
static const Bytes dstWrite = hex(
    "0607001e00e97604040207001e01000000000007001e021901240400"
    "14002400014044ba36ef8055fc4002007372be637d04"
    "14002401010000000000000000000000000000000000"
    "14002402010000000000000000000000000000000002");
static const Bytes namesReply = hex(
    "0614001f004d4144524944000000000000000000000000"
    "14001f064d4144000000000000000000000000000000"
    "14001f01285554432900000000000000000000000000"
    "14001f07555443000000000000000000000000000000"
    "14001f02544f4b594f00000000000000000000000000"
    "14001f0854594f000000000000000000000000000000");

static void capturedPackets() {
  CHECK(settingsReply.size() == kSettingsResponseSize);
  CHECK(settingsWrite.size() == kSettingsWriteSize);
  CHECK(cities.size() == kCitiesSize);
  CHECK(dstReply.size() == kDstResponseSize);
  CHECK(dstWrite.size() == kDstWriteSize);
  CHECK(namesReply.size() == kAlarmResponseSize);
  CHECK(kMinimumMtu == 136);

  // Sentinels exercise capacity larger than the write and preserve guard bytes.
  Bytes settings(kSettingsWriteSize + 2, 0xa5);
  Bytes savedCities(kCitiesSize + 2, 0x5a);
  CHECK(splitSettings(settingsReply.data(), settingsReply.size(), settings.data() + 1,
                      kSettingsWriteSize, savedCities.data() + 1, kCitiesSize));
  CHECK(std::equal(settingsWrite.begin(), settingsWrite.end(), settings.begin() + 1));
  CHECK(std::equal(cities.begin(), cities.end(), savedCities.begin() + 1));
  CHECK(settings.front() == 0xa5 && settings.back() == 0xa5);
  CHECK(savedCities.front() == 0x5a && savedCities.back() == 0x5a);

  Bytes dst(kDstWriteSize + 2, 0x81);
  CHECK(buildDst(dstReply.data(), dstReply.size(), savedCities.data() + 1, kCitiesSize,
                 dst.data() + 1, kDstWriteSize));
  CHECK(std::equal(dstWrite.begin(), dstWrite.end(), dst.begin() + 1));
  CHECK(dst.front() == 0x81 && dst.back() == 0x81);
  CHECK(validAlarms(namesReply.data(), namesReply.size()));

  // Explicitly reject the former whole-response settings echo and the former
  // 28-byte DST echo: successful results have distinct 35/94/133 lengths.
  CHECK(settingsWrite.size() != settingsReply.size());
  CHECK(dstWrite.size() != dstReply.size());
}

static void rejectedSettings(const uint8_t* response, size_t size,
                             size_t settingsCapacity = kSettingsWriteSize,
                             size_t citiesCapacity = kCitiesSize) {
  Bytes out(kSettingsWriteSize + 2, 0xa5);
  Bytes saved(kCitiesSize + 2, 0x5a);
  CHECK(!splitSettings(response, size, out.data(), settingsCapacity,
                       saved.data(), citiesCapacity));
  CHECK(std::all_of(out.begin(), out.end(), [](uint8_t value) { return value == 0xa5; }));
  CHECK(std::all_of(saved.begin(), saved.end(), [](uint8_t value) { return value == 0x5a; }));
}

static void rejectedDst(const uint8_t* response, size_t size,
                        const uint8_t* saved, size_t citiesSize,
                        size_t capacity = kDstWriteSize) {
  Bytes out(kDstWriteSize + 2, 0xa5);
  CHECK(!buildDst(response, size, saved, citiesSize, out.data(), capacity));
  CHECK(std::all_of(out.begin(), out.end(), [](uint8_t value) { return value == 0xa5; }));
}

static void rejectsMalformedSettings() {
  rejectedSettings(nullptr, kSettingsResponseSize);
  for (size_t size = 0; size < kSettingsResponseSize; ++size) {
    rejectedSettings(settingsReply.data(), size);
  }
  Bytes oversized = settingsReply;
  oversized.push_back(0);
  rejectedSettings(oversized.data(), oversized.size());
  for (size_t capacity = 0; capacity < kSettingsWriteSize; ++capacity) {
    rejectedSettings(settingsReply.data(), settingsReply.size(), capacity);
  }
  for (size_t capacity = 0; capacity < kCitiesSize; ++capacity) {
    rejectedSettings(settingsReply.data(), settingsReply.size(), kSettingsWriteSize, capacity);
  }

  Bytes broken = settingsReply;
  broken[0] = 0x02;
  rejectedSettings(broken.data(), broken.size());
  for (size_t offset : {size_t{1}, size_t{18}, size_t{35}, size_t{57}, size_t{79}}) {
    for (size_t field = 0; field < 4; ++field) {
      broken = settingsReply;
      broken[offset + field] ^= 1;
      rejectedSettings(broken.data(), broken.size());
    }
  }
  // Duplicate a city slot; also reject a reordered city pair.
  broken = settingsReply;
  broken[57 + 3] = 0;
  rejectedSettings(broken.data(), broken.size());
  broken = settingsReply;
  std::swap_ranges(broken.begin() + 35, broken.begin() + 57, broken.begin() + 57);
  rejectedSettings(broken.data(), broken.size());

  Bytes out(kSettingsResponseSize, 0xa5);
  CHECK(!splitSettings(settingsReply.data(), settingsReply.size(), nullptr,
                       kSettingsWriteSize, out.data(), out.size()));
  CHECK(!splitSettings(settingsReply.data(), settingsReply.size(), out.data(),
                       out.size(), nullptr, kCitiesSize));
  CHECK(!splitSettings(settingsReply.data(), settingsReply.size(), out.data(),
                       out.size(), out.data() + 10, kCitiesSize));
  CHECK(std::all_of(out.begin(), out.end(), [](uint8_t value) { return value == 0xa5; }));
}

static void rejectsMalformedDst() {
  rejectedDst(nullptr, kDstResponseSize, cities.data(), cities.size());
  rejectedDst(dstReply.data(), dstReply.size(), nullptr, kCitiesSize);
  for (size_t size = 0; size < kDstResponseSize; ++size) {
    rejectedDst(dstReply.data(), size, cities.data(), cities.size());
  }
  Bytes oversized = dstReply;
  oversized.push_back(0);
  rejectedDst(oversized.data(), oversized.size(), cities.data(), cities.size());
  for (size_t size = 0; size < kCitiesSize; ++size) {
    rejectedDst(dstReply.data(), dstReply.size(), cities.data(), size);
  }
  oversized = cities;
  oversized.push_back(0);
  rejectedDst(dstReply.data(), dstReply.size(), oversized.data(), oversized.size());
  for (size_t capacity = 0; capacity < kDstWriteSize; ++capacity) {
    rejectedDst(dstReply.data(), dstReply.size(), cities.data(), cities.size(), capacity);
  }

  Bytes broken = dstReply;
  broken[0] = 0x06;
  rejectedDst(broken.data(), broken.size(), cities.data(), cities.size());
  for (size_t offset : {size_t{1}, size_t{10}, size_t{19}}) {
    for (size_t field = 0; field < 4; ++field) {
      broken = dstReply;
      broken[offset + field] ^= 1;
      rejectedDst(broken.data(), broken.size(), cities.data(), cities.size());
    }
  }
  for (size_t offset : {size_t{0}, size_t{22}, size_t{44}}) {
    for (size_t field = 0; field < 4; ++field) {
      broken = cities;
      broken[offset + field] ^= 1;
      rejectedDst(dstReply.data(), dstReply.size(), broken.data(), broken.size());
    }
  }
  broken = dstReply;
  broken[10 + 3] = 0;
  rejectedDst(broken.data(), broken.size(), cities.data(), cities.size());
  CHECK(!buildDst(dstReply.data(), dstReply.size(), cities.data(), cities.size(),
                  nullptr, kDstWriteSize));
}

static void rejectsMalformedNames() {
  CHECK(!validAlarms(nullptr, kAlarmResponseSize));
  for (size_t size = 0; size < kAlarmResponseSize; ++size) {
    CHECK(!validAlarms(namesReply.data(), size));
  }
  Bytes broken = namesReply;
  broken.push_back(0);
  CHECK(!validAlarms(broken.data(), broken.size()));
  broken = namesReply;
  broken[0] = 0x03;
  CHECK(!validAlarms(broken.data(), broken.size()));
  for (size_t record = 0; record < 6; ++record) {
    for (size_t field = 0; field < 4; ++field) {
      broken = namesReply;
      broken[1 + record * 22 + field] ^= 1;
      CHECK(!validAlarms(broken.data(), broken.size()));
    }
  }
  broken = namesReply;
  broken[23 + 3] = 0;
  CHECK(!validAlarms(broken.data(), broken.size()));
}

static void preservesOpaqueData() {
  // Unknown fields must remain opaque, including the bytes the official app
  // rewrites to FF and arbitrary non-ASCII city names.
  Bytes modified = settingsReply;
  for (size_t offset : {size_t{1}, size_t{18}, size_t{35}, size_t{57}, size_t{79}}) {
    const size_t recordSize = offset < 35 ? 17 : 22;
    for (size_t byte = 4; byte < recordSize; ++byte) {
      modified[offset + byte] = static_cast<uint8_t>(0x80 + offset + byte);
    }
  }
  Bytes out(kSettingsWriteSize);
  Bytes saved(kCitiesSize);
  CHECK(splitSettings(modified.data(), modified.size(), out.data(), out.size(),
                      saved.data(), saved.size()));
  CHECK(out[0] == 0x02);
  CHECK(std::equal(modified.begin() + 1, modified.begin() + 35, out.begin() + 1));
  CHECK(std::equal(modified.begin() + 35, modified.end(), saved.begin()));

  Bytes changedDst = dstReply;
  for (size_t record = 0; record < 3; ++record) {
    for (size_t byte = 4; byte < 9; ++byte) {
      changedDst[1 + record * 9 + byte] = static_cast<uint8_t>(0xf0 + byte);
    }
  }
  Bytes final(kDstWriteSize);
  CHECK(buildDst(changedDst.data(), changedDst.size(), saved.data(), saved.size(),
                 final.data(), final.size()));
  CHECK(final[0] == 0x06);
  CHECK(std::equal(changedDst.begin() + 1, changedDst.end(), final.begin() + 1));
  CHECK(std::equal(saved.begin(), saved.end(), final.begin() + 28));

  Bytes changedNames = namesReply;
  for (size_t record = 0; record < 6; ++record) {
    for (size_t byte = 4; byte < 22; ++byte) changedNames[1 + record * 22 + byte] = 0xff;
  }
  CHECK(validAlarms(changedNames.data(), changedNames.size()));
}

static void supportsInputOutputAliasing() {
  Bytes reused = settingsReply;
  Bytes saved(kCitiesSize);
  CHECK(splitSettings(reused.data(), reused.size(), reused.data(), reused.size(),
                      saved.data(), saved.size()));
  CHECK(std::equal(settingsWrite.begin(), settingsWrite.end(), reused.begin()));
  CHECK(saved == cities);

  // Either of the two settings outputs may alias the response buffer.
  reused = settingsReply;
  Bytes settings(kSettingsWriteSize);
  CHECK(splitSettings(reused.data(), reused.size(), settings.data(), settings.size(),
                      reused.data(), reused.size()));
  CHECK(settings == settingsWrite);
  CHECK(std::equal(cities.begin(), cities.end(), reused.begin()));

  reused = dstReply;
  reused.resize(kDstWriteSize);
  CHECK(buildDst(reused.data(), kDstResponseSize, cities.data(), cities.size(),
                 reused.data(), reused.size()));
  CHECK(reused == dstWrite);

  reused = cities;
  reused.resize(kDstWriteSize);
  CHECK(buildDst(dstReply.data(), dstReply.size(), reused.data(), kCitiesSize,
                 reused.data(), reused.size()));
  CHECK(reused == dstWrite);
}

int main() {
  capturedPackets();
  rejectsMalformedSettings();
  rejectsMalformedDst();
  rejectsMalformedNames();
  preservesOpaqueData();
  supportsInputOutputAliasing();
  std::cout << "Casio BX protocol capture and malformed-packet checks passed\n";
}
