//
// RadioClock_V3_2_1_Casio_BLE_Reliability.ino
// Based on RadioClock_JJY40_HWTimer_Validated_V2.7; Casio time-only BLE protocol selection.
// Retains V2.7 RF timing, encoding, timezone, LittleFS, Wi-Fi power and flash-wear improvements.
// Scheduled watch-initiated BLE: GW-BX5600 MIP, Standard digital/hybrid, and experimental analogue time-only.
// JJY validation baseline:
//   NICT "The Method of Emitting Standard Time and Frequency Signal Emission"
//   https://jjy.nict.go.jp/jjy/trans/index-e.html
//
// Important implementation choice:
//   - ESP32 LEDC = hardware 40 kHz carrier
//   - ESP32 hardware timer = 1 kHz task wake; RF envelope phase follows system clock
//   - JJY envelope = 0.2/0.5/0.8 s, selected by system clock phase
//   - No software GPIO bit-banging of the 40 kHz carrier
//
// V3.2.1 builds on V3.2 and adds explicit first-time/replacement watch pairing:
//   - NimBLE-Arduino 2.5.1+ replaces the larger Bluedroid client stack.
//   - Pair Watch control added to Settings with safe temporary rebind mode.
  - Existing watch binding is replaced only after a successful pairing connection/time write.
  - Redesigned dashboard/navigation with progressive disclosure and mobile-first controls.
//   - Static web UI remains gzip-compressed in flash and streamed from PROGMEM.
//   - Fixes overlap-rotation stale indexing and single-core task startup.
//   - RF pause is a true quiescent barrier; timezone work stays out of radioTask.
//   - BLE discovery handoff no longer mutates shared String state from callback context.
//   - SSID/password/timezone inputs are validated instead of silently truncated/falling back.

// Using software radio on ESP32/ESP32-C3.
//
// (c) 2021 by taroh (sasaki.taroh@gmail.com) (origin)
//
// (c) 2025 by 5Breeze (bitshen@qq.com)(improve)
// Modified 2025: Added web UI, WiFi config, multi-station scheduling, station rotation
//
// Supported Radio Time Services:
// - JJY (Japan): NICT time-code specification
// - WWVB (US): NIST WWVB time-code specification
// - DCF77 (Germany): PTB DCF77 time-code specification
// - MSF (UK): NPL MSF time-code specification
// - BPC (China): 68.5 kHz China Standard Time signal
//
// Primary standards: JJY, WWVB, DCF77, MSF and BPC.
// BSF is retained only as a legacy experimental mode for compatibility with old schedules.
// This output is intended as a low-power local time-signal emulator, not a broadcast transmitter.

//...................................................................
// Hardware Configuration - Auto-detect ESP32 variant
#if defined(CONFIG_IDF_TARGET_ESP32C3)
  // ESP32-C3 GPIO Pins
  #define PIN_RADIO  (3)  // Radio signal output pin
  #define PIN_BUZZ    (4)  // Buzzer output pin
  #define PIN_LED    (5)  // LED indicator pin (envelope indicator)
  // ESP32-C3 devkits vary in which pin (if any) is a simple onboard LED
  // (many use GPIO8 for a WS2812 RGB LED instead). Rather than guess wrong
  // and drive a pin the board doesn't expect, default the "onboard LED" to
  // the same pin as PIN_LED here so the code still compiles/runs sensibly.
  #define PIN_ONBOARD_LED (5)
#else
  // ESP32 (Classic) GPIO Pins
  #define PIN_RADIO  (26) // Radio signal output pin
  #define PIN_BUZZ   (27) // Buzzer output pin
  #define PIN_LED    (25) // LED indicator pin (mirrors the RF envelope - flashes with the transmitted signal)
  // The original ESP32-DevKitC-style "ESP32 Dev Module" board has a fixed
  // onboard LED wired to GPIO2 (active HIGH). This is used here as a
  // separate system-status indicator (WiFi/AP state), independent of
  // PIN_LED which tracks the RF envelope.
  #define PIN_ONBOARD_LED (2)
#endif

// Library Includes
#include <WiFi.h>           // WiFi connectivity
#include <WebServer.h>      // HTTP web server
#include <LittleFS.h>        // File system for configuration storage (see initFilesystem())
// BLE central stack. NimBLE-Arduino 2.5.1+ substantially reduces
// flash/RAM use while retaining the Casio client protocols.
#include <NimBLEDevice.h>
#include <string>
#include <strings.h>
#include <ArduinoJson.h>    // JSON parsing and generation
#include <time.h>
#include <sys/time.h>
#include "esp_sntp.h"
#include "esp_timer.h"
#include <math.h>

// Global Objects
WebServer server(80);     // Web server on port 80
bool webRoutesRegistered=false;
bool webServerStarted=false;

// Configuration Constants
#define DEVICENAME_PREFIX "RadioStation"     // Device name prefix for WiFi AP mode
#define FIRMWARE_VERSION "V3.2.1"

#define DEFAULT_TZ_NAME "Asia/Tokyo"
#define CONFIG_FILE "/config.json"           // WiFi and timezone configuration file
#define STATION_CONFIG_FILE "/stations.json" // Station configuration file
#define CONFIG_TEMP_FILE "/config.tmp"
#define SCHEDULE_TEMP_FILE "/stations.tmp"

// WiFi Configuration Variables
char ssid[64] = "";                          // WiFi SSID (network name)
char passwd[64] = "";                        // WiFi password
String timezone_name = DEFAULT_TZ_NAME;           // IANA timezone name
int transmission_offset_minutes = 0;           // Extra offset (minutes) applied on top of the selected time zone's local time; 0 = exactly that zone's time
unsigned long wifi_connect_start = 0;        // Timestamp when WiFi connection started
#define WIFI_CONNECT_TIMEOUT 30000           // WiFi connection timeout: 30 seconds
#define WIFI_CONNECT_CHECK_INTERVAL 5000     // WiFi connection check interval: 5 seconds

//...................................................................
// Radio Station Definitions and Specifications

// Station Index Constants
#define SN_JJY_E  (0) // JJY Fukushima, Japan (40 KHz)
#define SN_JJY_W  (1) // JJY Fukuoka, Japan (60 KHz)
#define SN_WWVB (2)   // WWVB, United States (60 KHz)
#define SN_DCF77  (3) // DCF77, Germany (77.5 KHz)
#define SN_BSF  (4)   // BSF, Taiwan (77.5 KHz)
#define SN_MSF  (5)   // MSF, United Kingdom (60 KHz)
#define SN_BPC  (6)   // BPC, China (68.5 KHz)

#define SN_DEFAULT  (SN_JJY_E) // Default station
#define NUM_STATIONS 7         // Total number of supported stations

// Station Display Names (Full)
const char *station_names[] = {
  "JJY-E (40KHz)",
  "JJY-W (60KHz)",
  "WWVB (60KHz)",
  "DCF77 (77.5KHz)",
  "BSF (77.5 kHz, experimental carrier only)",
  "MSF (60KHz)",
  "BPC (68.5KHz)"
};

// Station Display Names (Short)
const char *station_short[] = {
  "JJY-E",
  "JJY-W",
  "WWVB",
  "DCF77",
  "BSF",
  "MSF",
  "BPC"
};

// Time Schedule Structure
// Defines when a specific radio station should be active
typedef struct {
  uint8_t station;      // Station index (0-6)
  uint16_t start_min;   // Start time in minutes from midnight (0-1439)
  uint16_t end_min;     // End time in minutes from midnight (0-1439)
} TimeSchedule;

// Schedule Storage
#define MAX_SCHEDULES 24                      // Maximum number of schedules
TimeSchedule schedules[MAX_SCHEDULES];        // Array of time schedules
int schedule_count = 0;                       // Current number of active schedules

// Multi-Station Rotation Control
// Used when multiple schedules overlap in time, causing the system to rotate between stations
#define ROTATION_INTERVAL_MINUTES 5           // Switch station every N minutes during rotation
int current_schedule_index = -1;              // Current selected schedule (-1 = none active)
unsigned long last_rotation_time = 0;         // Timestamp of last rotation event
int applicable_schedules[MAX_SCHEDULES];      // Array of currently applicable schedule indices
int applicable_count = 0;                     // Number of applicable schedules at current time
int last_station = -1;                        // Last selected station (prevents redundant switches)

//...................................................................
// Timer and Interrupt Configuration

// Time Base Constants
// Timer interrupt rate depends on frequency: 1 KHz base frequency
// AMPDIV: Amplitude update frequency (10 Hz)
// SSECDIV: Second tick frequency (1 Hz)
#define AMPDIV   (100)  // 1 KHz / 100 => 10 Hz (amplitude update every 0.1 seconds)
#define SSECDIV   (10)  // 10 Hz / 10 => 1 Hz (clock tick every 1 second)

// Time-code bit-position markers used throughout the mb_*() encoders below
// as the values written into txSymbol[]/parity()'s input.
#define SP_0  (0)  // Binary 0 symbol
#define SP_1  (1)  // Binary 1 symbol
#define SP_M  (2)  // Minute/position marker symbol
#define SP_M4 (4)  // BPC: marks the frame-start second of each 20-second block in txSymbol[] (see mb_bpc())

// (Earlier revisions of this file also built each minute's frame from a set
// of static per-station template arrays - bits_jjy[]/sp_jjy[]/bits_dcf[]/
// etc, indexed via st_bits[]/st_sp[]/bits60/secpattern. That machinery was
// removed during cleanup: it was fully superseded by the mb_jjy()/mb_wwvb()/
// mb_dcf()/mb_msf()/mb_bpc() functions further down, which compute the
// actual current time via stationTime() and write directly into
// txSymbol[60]/txEnvelope[60][10] - the arrays ampchange() actually reads
// to drive the RF envelope. The old arrays were assigned on every station
// switch but never read by anything, so they were pure dead weight. If
// you're looking for how a station's time code is actually built, start at
// mb_jjy() etc., not here.)

// Function Declarations: Time Code Pattern Generation

/**
 * Generate JJY (Fukushima/Fukuoka) time code pattern for the current second
 * Encodes: year, month, day, hour, minute, second, day-of-week, leap second, parity
 */
void mb_jjy(void);

/**
 * Generate WWVB (US) time code pattern for the current second
 * Encodes: year, month, day, hour, minute, second, day-of-year, leap second, parity
 */
void mb_wwvb(void);

/**
 * Generate DCF77 (Germany) time code pattern for the current second
 * Encodes: minute, hour, day, month, year, day-of-week, time-zone, parity, leap second
 */
void mb_dcf(void);

/**
 * Generate BSF (Taiwan) time code pattern for the current second
 * Uses quad (4-level) encoding for denser data
 */
void mb_bsf(void);

/**
 * Generate MSF (UK) time code pattern for the current second
 * Encodes: minute, hour, day, month, year, day-of-week, leap second, parity
 */
void mb_msf(void);
void mb_bpc(void);

// Dedicated high-priority FreeRTOS task that performs all time-critical
// radio signal generation, woken directly by the hardware timer ISR.
void radioTask(void *pvParameters);
const char *stationEncodingName(int station);
const char *txFieldDescription(int station, int second);

// Applies the configured "Time zone" card selection to the C library as a
// POSIX TZ rule (see posixTzFor()/applyTimezone() below), used by both the
// displayed clock and the transmitted time code.
static void applyTimezone(void);
static void sendIndexPage(void);

// WiFi power management (Scheduled/power-save mode) - see definitions near
// checkWiFiConnection() for full explanation.
bool shouldWifiBeOnForSchedule(void);
void updateWifiPowerManagement(void);

// Debounced config persistence (flash-wear mitigation) - see definition
// near saveConfig()/writeConfigNow().
void writeConfigNow(void);
bool saveSchedules(void);
void normalizeBluetoothSlots();

// txSymbol/txEnvelope are THE active buffers: each mb_*() encoder writes
// this minute's frame directly into them, and ampchange() (in radioTask)
// reads txEnvelope every 1 ms to drive the RF carrier's PWM duty. See the
// notice above SP_0/SP_1/SP_M for what used to sit here instead.
uint8_t txEnvelope[60][10]; // 0=carrier off, 1=full carrier, 2=reduced carrier
uint8_t txSymbol[60];
uint32_t carrierFrequencyHz = 40000;
bool carrierReady = false;

// Function pointer lookup table: maps station index to its pattern generation function
void (*st_makebits[])(void) = {mb_jjy, mb_jjy, mb_wwvb, mb_dcf, mb_bsf, mb_msf, mb_bpc};
void (*makebitpattern)(void);  // Function pointer to current station's pattern generator

// LEDC carrier configuration. The LF carrier is generated entirely by hardware.
// 10-bit resolution gives a useful frequency/resolution tradeoff at 40-77.5 kHz.
#define RF_PWM_RESOLUTION 10
#define RF_PWM_CHANNEL    0

// LEDC duty controls the carrier waveform itself. 100% duty would produce a
// constant DC level and therefore NO LF carrier. The full carrier must be
// approximately 50% duty.
// Reduced-carrier values below are PWM-duty approximations for a resonant RF
// output stage. Exact 10%/15% RF amplitude requires an external attenuator or
// amplifier control; PWM duty is not linearly proportional to RF amplitude.
#define RF_DUTY_FULL  ((1U << RF_PWM_RESOLUTION) / 2U)

// Approximate the fundamental RF amplitude ratios with a narrow-duty PWM
// waveform. These values are intended for a tuned/resonant LF output stage.
#define RF_DUTY_JJY_REDUCED ((1U << RF_PWM_RESOLUTION) * 32U / 1000U)  // ~10% fundamental
#define RF_DUTY_WWVB_REDUCED ((1U << RF_PWM_RESOLUTION) * 32U / 1000U) // ~10% fundamental
#define RF_DUTY_DCF_REDUCED ((1U << RF_PWM_RESOLUTION) * 48U / 1000U)  // ~15% fundamental
#define RF_DUTY_BPC_REDUCED ((1U << RF_PWM_RESOLUTION) * 32U / 1000U) // ~10% fundamental

//...................................................................
// Hardware Timer and Interrupt Handling

// Hardware Timer 0 provides the deterministic 1 kHz envelope/time base.
// LEDC generates the RF carrier entirely in hardware.  This avoids bit-banging
// the 40 kHz carrier and keeps the carrier frequency independent of FreeRTOS loop jitter.
hw_timer_t *tm0 = NULL;  // ESP32 hardware timer handle

// Timer interrupt synchronization
// The ISR notifies a dedicated task. Every wake derives the current phase
// from the system clock so delayed ticks do not shift subsequent envelope edges.
TaskHandle_t radioTaskHandle = NULL;  // Dedicated high-priority radio-timing task

// Priority chosen to sit comfortably above the default Arduino loopTask
// (priority 1, which runs the web server / Serial / WiFi housekeeping) so
// it always preempts them, but below the ESP-IDF WiFi and TCP/IP stack
// tasks (typically priority ~18-23) so this task never starves the
// networking stack it depends on for NTP.
#define RADIO_TASK_PRIORITY  3

// Timer state flag
int istimerstarted = 0;  // 1 if timer is running, 0 if stopped

//...................................................................
// Interrupt Counter Variables
// These track the 1 kHz housekeeping tick and the 10 Hz modulation frame.

int ampc = 0;    // Amplitude cycle counter: 0..(AMPDIV - 1), generates 10 Hz updates
int tssec = 0;   // Time base counter: 0..(SSECDIV - 1), generates 1 Hz clock ticks

//...................................................................
// Network Time and Synchronization

int ntpsync = 1;  // NTP synchronization flag: 1 = synchronized, 0 = not synchronized
bool full_time_tx = false; // Continuous transmission mode
int full_time_station = SN_JJY_E; // Radio type used in full-time mode
struct tm nowtm;  // Broken-down current LOCAL time in the selected timezone (see getlocaltime()); drives the clock display, schedule matching, and (via stationTime()) the transmitted time code.
volatile bool ntpSyncEvent = false;

// Set by the web-server task (loop()/HTTP handlers) whenever a change is
// made that affects what is encoded in the radio signal (transmission
// offset, full-time mode/station, timezone). The actual regeneration of
// txSymbol[]/txEnvelope[] is always performed by radioTask, never by the
// web handler itself, because those arrays are also read every 1 ms by
// ampchange() in radioTask - having two tasks write them concurrently could
// tear a read mid-update. radioTask checks this flag on every 1 kHz tick,
// so the encoding (and therefore the UI, which polls /api/status) updates
// within at most ~1 ms of the change being made.
volatile bool encodingRefreshRequested = false;
// The radio task is the ONLY runtime owner of LEDC, station and RF duty.
// Timer stays running through idle and BLE pauses; commands wake radioTask.
volatile bool radioPauseRequested = false;
volatile bool radioResumeRequested = false;
volatile bool radioPaused = false;
volatile bool radioPauseAck = false;
volatile int radioBoundaryErrorUs = 0;
volatile uint32_t radioBoundaryWorstUs = 0;
volatile uint32_t radioMissedBoundaries = 0;
volatile uint32_t radioProcessedSecond = 0;
// RadioTask queues small snapshots; loop() performs potentially blocking Serial IO.
portMUX_TYPE radioLogMux = portMUX_INITIALIZER_UNLOCKED;
volatile bool radioPatternLogPending = false;
volatile bool radioSecondLogPending = false;
uint8_t radioLogBits[60] = {};
int radioLogStation = -1;
uint32_t radioLogHz = 0;
struct tm radioSecondTm = {};
int radioSecondStation = -1;
void queuePatternLog(int station) {
  if (station < 0 || station >= NUM_STATIONS) return;
  portENTER_CRITICAL(&radioLogMux);
  memcpy(radioLogBits, txSymbol, sizeof(radioLogBits));
  radioLogStation = station; radioLogHz = carrierFrequencyHz;
  radioPatternLogPending = true;
  portEXIT_CRITICAL(&radioLogMux);
}
void queueSecondLog(int station) {
  if (station < 0 || station >= NUM_STATIONS) return;
  portENTER_CRITICAL(&radioLogMux);
  radioSecondTm = nowtm; radioSecondStation = station;
  radioSecondLogPending = true;
  portEXIT_CRITICAL(&radioLogMux);
}
void radioRequestRefresh() { encodingRefreshRequested = true; if (radioTaskHandle) xTaskNotifyGive(radioTaskHandle); }
bool radioSetPaused(bool pause) {
  if (!radioTaskHandle) { radioPaused = pause; return true; }
  radioPauseAck = false;
  if (pause) radioPauseRequested = true; else radioResumeRequested = true;
  xTaskNotifyGive(radioTaskHandle);
  uint32_t started = millis();
  while (!radioPauseAck && millis() - started < 2000) delay(1);
  if (!radioPauseAck) Serial.println("ERROR: radio command acknowledgement timed out");
  return radioPauseAck && radioPaused == pause;
}

// --- Adaptive NTP resync interval ---
// Rather than resyncing on a fixed schedule, this measures how much the
// board's own clock actually drifts between syncs and shortens/lengthens
// the resync interval to match - a board with a more accurate crystal gets
// resynced less often (saving a WiFi/NTP round-trip), a drifty one gets
// resynced more often, and either way the clock stays within roughly
// NTP_ERROR_BUDGET_SEC seconds of correct between syncs. See onNtpSync()
// (measures the drift on every successful sync) and configureAdaptiveNtp()
// (turns that measurement into a new resync interval).
portMUX_TYPE clockMux = portMUX_INITIALIZER_UNLOCKED;
uint64_t ntpLastMonoUs = 0;         // esp_timer (monotonic) time at the previous sync, microseconds
int64_t ntpLastEpochUs = 0;         // Wall-clock (epoch) time at the previous sync, microseconds
double ntpDriftPpm = 0.0;           // Smoothed clock drift estimate, parts-per-million
double ntpDriftAbsSecPerHour = 0.0; // Same drift, expressed as seconds/hour (for logging/diagnostics)
// Validity comes ONLY from the SNTP callback, not a plausible clock year.
// A conservative 50 ppm estimate is used until real drift samples exist.
static const double CLOCK_INITIAL_PPM = 50.0;
static const uint32_t CLOCK_MAX_HOLDOVER_SEC = 21600UL;
static const double CLOCK_INITIAL_UNCERTAINTY_SEC = 0.20;
uint32_t ntpIntervalSec = 3600;
static bool clockNtpEverSynced = false;
static uint32_t clockNtpSyncCount = 0;
uint32_t clockAgeSeconds() {
  portENTER_CRITICAL(&clockMux);
  bool valid=clockNtpEverSynced;
  uint64_t snapshot=ntpLastMonoUs;
  portEXIT_CRITICAL(&clockMux);
  if (!valid || !snapshot) return UINT32_MAX;
  int64_t age = esp_timer_get_time() - (int64_t)snapshot;
  return age < 0 ? UINT32_MAX : (uint32_t)(age / 1000000LL);
}
double clockEstimatedError() {
  uint32_t age = clockAgeSeconds();
  if (age == UINT32_MAX) return 9999.0;
  portENTER_CRITICAL(&clockMux);
  uint32_t count=clockNtpSyncCount;
  double drift=ntpDriftPpm;
  portEXIT_CRITICAL(&clockMux);
  double ppm = count < 2 ? CLOCK_INITIAL_PPM : fabs(drift);
  return CLOCK_INITIAL_UNCERTAINTY_SEC + ppm * (double)age / 1000000.0;
}
const char *clockConfidence() {
  uint32_t age = clockAgeSeconds();
  if (age == UINT32_MAX || age > CLOCK_MAX_HOLDOVER_SEC || clockEstimatedError() > 0.90) return "Unsynchronized";
  return age <= ntpIntervalSec ? "Synchronized" : "Holdover";
}
bool clockTrusted() { return strcmp(clockConfidence(), "Unsynchronized") != 0; }     // Current resync interval, recalculated by configureAdaptiveNtp()
#define NTP_INITIAL_INTERVAL_SEC 3600UL   // Resync interval before any drift has been measured yet
#define NTP_MIN_INTERVAL_SEC 900UL        // Never resync more often than this, even for a very drifty clock
#define NTP_MAX_INTERVAL_SEC 86400UL      // Never wait longer than this between resyncs, even for a very accurate clock
#define NTP_ERROR_BUDGET_SEC 0.90         // Target maximum clock error to tolerate between resyncs
#define NTP_DRIFT_EMA_ALPHA 0.35          // Smoothing factor (0-1) for the drift estimate; higher = reacts faster to new measurements, lower = more stable against noisy single measurements

//...................................................................
// Casio BLE time-only profiles. Values are persisted: do not reorder.
// 0: GW-BX5600 MIP with the model-specific four-step SP handshake.
// 1: Standard digital / hybrid (10-byte current-time write).
// 2: Analogue/MT-G experimental time-only (same inherited standard time write;
//    motor/second-dial setup is intentionally never written).
// Do not send MIP packets to other MIP models without validating their handshake.
enum CasioBleProtocol : uint8_t {
  BT_PROTOCOL_BX5600_MIP = 0,
  BT_PROTOCOL_STANDARD = 1,
  BT_PROTOCOL_ANALOGUE = 2,
  BT_PROTOCOL_COUNT = 3
};
static bool validBtProtocol(int p) { return p >= 0 && p < BT_PROTOCOL_COUNT; }
static const char *btProtocolName(int p) {
  switch (p) {
    case BT_PROTOCOL_BX5600_MIP: return "GW-BX5600 MIP";
    case BT_PROTOCOL_STANDARD: return "Standard digital/hybrid";
    case BT_PROTOCOL_ANALOGUE: return "Analogue time-only (experimental)";
    default: return "Unknown Casio protocol";
  }
}

// Casio GW-BX5600 BLE time synchronization
// Watch-initiated connection model: the ESP32 opens a scan window and
// waits for the watch to advertise its Casio Bluetooth service.
#define CASIO_ADVERTISEMENT_SERVICE "1804"
#define CASIO_WATCH_FEATURES_SERVICE "26eb000d-b012-49a8-b1f8-394fb2032b0f"
#define CASIO_SP_REQUEST_CHAR       "26eb002e-b012-49a8-b1f8-394fb2032b0f"
#define CASIO_SP_DATA_CHAR          "26eb002f-b012-49a8-b1f8-394fb2032b0f"
#define CASIO_SET_CHAR              "26eb002d-b012-49a8-b1f8-394fb2032b0f"

#define BT_SYNC_SLOT_COUNT 4
#define BT_PREPARE_MINUTES 2
#define BT_WINDOW_AFTER_MINUTES 3
#define BT_REQUEST_TIMEOUT_MS 5000UL
#define BT_SCAN_SLICE_MS 1000UL

int btSyncTimes[BT_SYNC_SLOT_COUNT] = {30, 390, 750, 1110}; // 00:30, 06:30, 12:30, 18:30
bool btSyncEnabled[BT_SYNC_SLOT_COUNT] = {true, true, true, true};
uint8_t btSyncProtocol[BT_SYNC_SLOT_COUNT] = {BT_PROTOCOL_BX5600_MIP, BT_PROTOCOL_BX5600_MIP,
                                            BT_PROTOCOL_BX5600_MIP, BT_PROTOCOL_BX5600_MIP};
uint8_t btManualProtocol = BT_PROTOCOL_BX5600_MIP;
uint8_t btActiveProtocol = BT_PROTOCOL_BX5600_MIP;
#define BT_WATCH_PROFILE_COUNT 4
uint8_t btSyncProfile[BT_SYNC_SLOT_COUNT] = {0,0,0,0};
uint8_t btManualProfile = 0;
uint8_t btActiveProfile = 0;
int btProfileSuccessYear[BT_WATCH_PROFILE_COUNT] = {-1,-1,-1,-1};
int btProfileSuccessYday[BT_WATCH_PROFILE_COUNT] = {-1,-1,-1,-1};
String btProfileAddress[BT_WATCH_PROFILE_COUNT]; // Learned watch address; may change with BLE privacy.
String btProfileName[BT_WATCH_PROFILE_COUNT];
uint8_t btLastWatchAddressType = 0xFF;
uint32_t btConnectionAttempts = 0;
uint32_t btWriteAcknowledgements = 0;
uint32_t btNotifications = 0;
uint32_t btResponseErrors = 0;
const char *btDeliveryEvidence = "No delivery yet";
bool btProfileDoneToday(int profile) {
  if (profile < 0 || profile >= BT_WATCH_PROFILE_COUNT) return false;
  time_t now = time(nullptr); struct tm day; localtime_r(&now, &day);
  return btProfileSuccessYear[profile] == day.tm_year + 1900 &&
         btProfileSuccessYday[profile] == day.tm_yday;
}
// Circular distance between two clock times: handles midnight rollover.
int btCircularDistance(int a, int b) { int d = abs(a-b); return d < 720 ? d : 1440-d; }
bool btOverlapsOtherEnabledSlot(int slot,int minute) {
  for (int i=0;i<BT_SYNC_SLOT_COUNT;++i)
    if (i!=slot && btSyncEnabled[i] && btCircularDistance(btSyncTimes[i],minute) <=
        BT_PREPARE_MINUTES + BT_WINDOW_AFTER_MINUTES + 1) return true;
  return false;
}
// Completion is per protocol: a BX5600 success does not suppress a separately
// scheduled Standard or Analogue watch. Manual sync is always possible.
int btSuccessYear[BT_PROTOCOL_COUNT] = {-1, -1, -1};
int btSuccessYday[BT_PROTOCOL_COUNT] = {-1, -1, -1};
bool btSyncDayComplete = false;
int btSyncLastYear = -1;
int btSyncLastYday = -1;
int btSyncActiveSlot = -1;
unsigned long btWindowEndMillis = 0;
int btSlotAttemptYear[BT_SYNC_SLOT_COUNT] = {-1,-1,-1,-1};
int btSlotAttemptYday[BT_SYNC_SLOT_COUNT] = {-1,-1,-1,-1};
volatile bool btWindowActive = false;
bool btManualSyncRequested = false;
// Pair mode deliberately ignores the currently learned address for the selected
// profile, but does not erase that binding until the new watch has completed a
// successful connection/time write. This makes a failed re-pair attempt safe.
bool btPairRequested = false;
bool btPairModeActive = false;
bool btBleInitialized = false;
volatile bool btBleBusy = false;
String btLastWatchName = "";
String btLastWatchAddress = "";
String btLastSyncStatus = "Never synced";
String btLastSyncDate = "";

NimBLEScan *btScan = nullptr;
NimBLEClient *btClient = nullptr;
NimBLERemoteService *btService = nullptr;
NimBLERemoteCharacteristic *btSpRequest = nullptr;
NimBLERemoteCharacteristic *btSpData = nullptr;
NimBLERemoteCharacteristic *btSetChar = nullptr;

// Scan callbacks run on the NimBLE host task. Never mutate shared Arduino
// String objects there: publish a fixed-size discovery snapshot and let loop() consume it.
volatile bool btDiscoveryReady = false;
char btDiscoveredName[48] = {};
char btDiscoveredAddress[18] = {};
char btExpectedProfileAddress[18] = {};
uint8_t btDiscoveredAddressType = 0xFF;
portMUX_TYPE btDiscoveryMux = portMUX_INITIALIZER_UNLOCKED;

volatile bool btResponseActive = false;
volatile uint8_t btExpectedHeader = 0;
volatile size_t btResponseLength = 0;
#define BT_RESPONSE_CAPACITY 512
uint8_t btResponseBuffer[BT_RESPONSE_CAPACITY];
volatile unsigned long btLastFragmentMillis = 0;
volatile bool btResponseOverflow = false;
portMUX_TYPE btResponseMux = portMUX_INITIALIZER_UNLOCKED;

void initBluetoothSync(void);
void serviceBluetoothSync(void);
bool performGShockBX5600Sync(void);
bool performCasioStandardTimeSync(int protocol);
static bool btWatchNameMatches(int protocol, const String &name);
bool bluetoothTimeSlotConflicts(int minuteOfDay);
void resetBluetoothDayIfNeeded(void);
void startBluetoothWindow(int slot);
void stopBluetoothWindow(void);


//...................................................................
// Output Control Variables

int buzzout = 0;   // Current buzzer output pin value (0 or 1)

/**
 * Amplitude modulation value for current second
 * 1 = radio output active (transmitting)
 * 0 = radio output reduced (no transmission)
 * Applied to current amplitude subsecond within the second frame
 */
int ampmod;

/**
 * Buzzer control flag
 * 1 = sound on (generate buzzer output)
 * 0 = sound off (suppress buzzer output)
 */
int buzzsw = 1;

//...................................................................
// WiFi Access Point Mode Configuration

bool ap_mode = false;              // WiFi mode flag: true = AP mode, false = STA mode
unsigned long last_wifi_check = 0; // Timestamp of last WiFi connection check
unsigned long last_led_blink = 0;  // Timestamp of last onboard-LED toggle (WiFi status indicator)
bool onboardLedState = false;      // Current onboard-LED output state

//...................................................................
// WiFi power management ("Always on" vs "Scheduled/power-save")
//
// In Scheduled mode, WiFi is kept off except: (1) for a fixed window right
// after boot, so the device is always reachable to configure, and (2) for a
// lead-time window before each configured schedule's start, long enough to
// reconnect and get a fresh NTP fix. WiFi is deliberately OFF during the
// scheduled transmission itself - besides the obvious power saving, this
// also avoids the WiFi radio's own TX bursts/current spikes sitting right
// next to the antenna loop during transmission (a real interference source
// we identified and worked around earlier for this exact hardware).
#define WIFI_POWER_ALWAYS_ON  0
#define WIFI_POWER_SCHEDULED  1
int wifiPowerMode = WIFI_POWER_ALWAYS_ON;   // persisted config value

#define WIFI_BOOT_ON_DURATION_MS      (5UL * 60UL * 1000UL)   // 5 minutes
#define WIFI_PRE_SCHEDULE_LEAD_MIN    10                       // minutes
#define WIFI_PERIODIC_WAKE_INTERVAL_MS (6UL * 60UL * 60UL * 1000UL) // 6 hours
#define WIFI_PERIODIC_WAKE_DURATION_MS (10UL * 60UL * 1000UL)  // 10 minutes

bool wifiRadioEnabled = true;       // Our own intended on/off state (Scheduled mode only)
unsigned long bootMillis = 0;       // Set once in setup(); anchors the post-boot on-window

//...................................................................
// Debounced config persistence (flash-wear mitigation). Declared here,
// before loop(), because loop() reads these directly - unlike functions,
// plain variables/#defines are not auto-forward-declared by the Arduino
// build system, so they must appear in the file before first use. See the
// full explanation next to writeConfigNow()/saveConfig().
#define CONFIG_SAVE_DEBOUNCE_MS  3000
bool configDirty = false;
unsigned long configDirtyBecause = 0;

// extern 
void IRAM_ATTR onTimer(void)
{
  // 1 kHz hardware-timer tick.
  // The ISR does not generate the RF carrier; LEDC does that in hardware.
  // Keeping the ISR to a single notification call minimizes interrupt
  // latency and timing jitter. The notification is only a wakeup source:
  // if several ticks accumulate they can be coalesced because radioTask
  // derives second/subsecond phase from gettimeofday().
  BaseType_t hpTaskWoken = pdFALSE;
  if (radioTaskHandle != NULL) {
    vTaskNotifyGiveFromISR(radioTaskHandle, &hpTaskWoken);
  }
  if (hpTaskWoken) portYIELD_FROM_ISR();
}

//...................................................................
void setup(void)
{
  Serial.begin(115200);
  delay(100);
  Serial.printf("started... (firmware %s)\n", FIRMWARE_VERSION);
  bootMillis = millis();

  // Flash-wear mitigation #1: by default, Arduino-ESP32's WiFi.begin()
  // silently writes the SSID/password into the NVS flash partition on
  // EVERY call, regardless of whether they changed. This app already
  // persists credentials itself (see loadConfig()/saveConfig() and
  // LittleFS below), so that automatic NVS write is pure redundant flash
  // wear - and with WiFi power-save mode calling WiFi.begin() again on
  // every scheduled wake-up, it would otherwise repeat many times a day.
  // Disabling it here, once, removes that entirely; nothing else in this
  // sketch relies on the WiFi library's own credential persistence.
  WiFi.persistent(false);

  // Onboard LED (see PIN_ONBOARD_LED): used purely as a WiFi/AP status
  // indicator, independent of PIN_LED which mirrors the RF envelope. Set
  // up first so it can reflect connection attempts as soon as they start.
  pinMode(PIN_ONBOARD_LED, OUTPUT);
  digitalWrite(PIN_ONBOARD_LED, LOW);

  // Initialize LittleFS for configuration storage
  initFilesystem();
  
  // Load configuration from flash
  loadConfig();
  // Apply the configured time zone (mapped to a POSIX TZ rule so DST is
  // handled correctly) before any local-time calculations. This keeps the
  // UI and scheduler correct even before the first NTP reply.
  if (timezone_name.length() > 0) {
    applyTimezone();
  }
  loadSchedules();
  normalizeBluetoothSlots();
  initBluetoothSync();

  // Check if WiFi credentials are configured
  if (strlen(ssid) == 0) {
    Serial.println("No WiFi config found, starting AP mode for configuration...");
    startAPMode();
  } else {
    // Try to connect to WiFi
    if (ntpsync) {
      ntpstart();
    }
    // If WiFi connection established, start web server
    if (WiFi.status() == WL_CONNECTED) {
      IPAddress ip = WiFi.localIP();
      Serial.printf("WiFi connected! Web server at http://%s\n", ip.toString().c_str());
      initWebServer();
      Serial.println("Web server started");
      digitalWrite(PIN_ONBOARD_LED, HIGH);  // solid = connected
    } else if (!ntpsync && strlen(ssid) > 0) {
      Serial.println("WiFi connection failed, starting AP mode...");
      startAPMode();
    }
  }

  pinMode(PIN_RADIO, OUTPUT);
  pinMode(PIN_BUZZ, OUTPUT);
  digitalWrite(PIN_BUZZ, LOW);
  buzzout = 0;
  pinMode(PIN_LED, OUTPUT);
  digitalWrite(PIN_LED, LOW);

  // Start the dedicated radio-timing task BEFORE the hardware timer/LEDC
  // carrier are enabled (applyCurrentSchedule() -> setstation() ->
  // starttimer() below arms the 1 kHz interrupt), so radioTaskHandle is
  // valid the instant the first tick can arrive.
  //
  // On dual-core ESP32, pin alongside Arduino loopTask on core 1 so the
  // timing task can preempt web work without occupying the Wi-Fi core. ESP32-C3
  // is single-core, so use the unpinned API there. Always check creation: the
  // timer must never be armed if no task exists to consume its notifications.
  BaseType_t taskCreated;
#if CONFIG_FREERTOS_UNICORE
  taskCreated = xTaskCreate(radioTask, "radioTask", 4096, NULL,
                            RADIO_TASK_PRIORITY, &radioTaskHandle);
#else
  taskCreated = xTaskCreatePinnedToCore(radioTask, "radioTask", 4096, NULL,
                                        RADIO_TASK_PRIORITY, &radioTaskHandle, 1);
#endif
  if (taskCreated != pdPASS || radioTaskHandle == nullptr) {
    radioTaskHandle = nullptr;
    digitalWrite(PIN_RADIO, LOW);
    digitalWrite(PIN_LED, LOW);
    digitalWrite(PIN_BUZZ, LOW);
    Serial.println("FATAL: radioTask creation failed; RF left safely off");
    return;
  }

  starttimer();
  radioRequestRefresh();
  Serial.print("radio task and aligned scheduler started.\n");
}

// Dedicated, high-priority task that performs ALL time-critical radio
// signal work. It is woken directly by the hardware timer ISR via a task
// notification. Its RF phase never depends on counting notifications:
// every wake samples gettimeofday(), so if several 1 ms notifications build
// up while a higher-priority system task runs they may be coalesced safely
// instead of being replayed late. Normal envelope edges remain locked to the
// wall-clock 100 ms boundaries.
//
// No delay() of any kind appears in this task; it blocks only on the
// hardware-timer-driven notification and always derives phase from real time.
void radioTask(void *pvParameters)
{
  int64_t lastBoundary = -1;
  int lastMinute = -1;
  int lastSecond = -1;
  int lastSlot = -1;
  for (;;) {
    (void)ulTaskNotifyTake(pdTRUE, portMAX_DELAY);
    if (radioPauseRequested) {
      radioPauseRequested = false;
      radioPaused = true;
      if (carrierReady) ledcWrite(PIN_RADIO, 0);
      digitalWrite(PIN_LED, LOW);
      digitalWrite(PIN_BUZZ, LOW);
      buzzout = 0;
      ampmod = 0;
      radioPauseAck = true;
    }
    if (radioResumeRequested) {
      radioResumeRequested = false;
      radioPaused = false;
      encodingRefreshRequested = true;
      radioPauseAck = true;
    }
    // Paused means quiescent: no schedule reads, frame regeneration or RF
    // writes. Web/config code relies on this acknowledgement as a barrier.
    if (radioPaused) {
      if (carrierReady) ledcWrite(PIN_RADIO, 0);
      digitalWrite(PIN_LED, LOW);
      digitalWrite(PIN_BUZZ, LOW);
      buzzout = 0;
      ampmod = 0;
      continue;
    }
    // Derive the frame phase from the wall-clock on every wake; do not
    // assume the timer was started exactly on a second boundary.
    struct timeval tv; gettimeofday(&tv, nullptr);
    int second = (int)(tv.tv_sec % 60);
    int slot = (int)(tv.tv_usec / 100000);
    if (slot > 9) slot = 9;
    int64_t boundary = tv.tv_sec;
    bool boundaryChanged = lastBoundary != boundary;
    bool frameRefreshed = false;
    if (boundaryChanged || encodingRefreshRequested) {
      if (lastBoundary >= 0 && boundary > lastBoundary + 1)
        radioMissedBoundaries += (uint32_t)(boundary - lastBoundary - 1);
      if (lastBoundary != boundary) {
        // Diagnostic: callback arrival delay within this second; not a
        // calibrated RF edge measurement, but useful for detecting overload.
        radioBoundaryErrorUs = (int)tv.tv_usec;
        if ((uint32_t)tv.tv_usec > radioBoundaryWorstUs) radioBoundaryWorstUs = tv.tv_usec;
        ++radioProcessedSecond;
      }
      lastBoundary = boundary;
      getlocaltime();
      applyCurrentSchedule();
      bool refresh = encodingRefreshRequested || nowtm.tm_min != lastMinute || lastSecond < 0;
      encodingRefreshRequested = false;
      if (refresh && makebitpattern && last_station >= 0) {
        makebitpattern();
        frameRefreshed = true;
        if (last_station != SN_BPC) queuePatternLog(last_station);
      }
      if (last_station == SN_BPC && lastSecond != nowtm.tm_sec && (nowtm.tm_sec % 20) == 0)
        queuePatternLog(last_station);
      if (boundaryChanged && last_station >= 0) queueSecondLog(last_station);
      lastMinute = nowtm.tm_min;
      lastSecond = nowtm.tm_sec;
    }
    tssec = slot;
    if (second != nowtm.tm_sec) getlocaltime();
    if (lastSlot != slot || boundaryChanged || frameRefreshed) ampchange();
    lastSlot = slot;
    // The output buzzer represents the envelope and is not an RF carrier.
    if (ampmod && buzzsw) buzzout = !buzzout;
    else buzzout = 0;
    digitalWrite(PIN_BUZZ, buzzout ? HIGH : LOW);
  }
}

// loop() now only handles non-time-critical housekeeping: WiFi supervision,
// SNTP bookkeeping, and the web server. It contains no delay() calls and
// never touches the radio envelope directly - all of that lives in
// radioTask(), driven purely by the hardware timer.
void flushRadioLogs() {
  bool pattern, second;
  uint8_t bits[60]; int patternStation, secondStation;
  uint32_t hz; struct tm snapshot;
  portENTER_CRITICAL(&radioLogMux);
  pattern = radioPatternLogPending; second = radioSecondLogPending;
  if (pattern) { memcpy(bits,radioLogBits,sizeof(bits)); patternStation=radioLogStation; hz=radioLogHz; radioPatternLogPending=false; }
  if (second) { snapshot=radioSecondTm; secondStation=radioSecondStation; radioSecondLogPending=false; }
  portEXIT_CRITICAL(&radioLogMux);
  if (pattern && patternStation >= 0 && patternStation < NUM_STATIONS) {
    Serial.print("PATTERN: ");
    for (int i=0; i<60; ++i) Serial.print(bits[i]);
    Serial.printf("\nPATTERN REPEAT: %s | encoding=%s | frequency=%lu Hz (%.3f kHz) | frame=%lus\n",
       station_names[patternStation], stationEncodingName(patternStation),
       (unsigned long)hz, hz/1000.0, (unsigned long)(patternStation==SN_BPC?20:60));
  }
  if (second && secondStation >= 0 && secondStation < NUM_STATIONS) {
    const char *field=txFieldDescription(secondStation,snapshot.tm_sec);
    Serial.printf("TX %02d:%02d:%02d | %s | %s\n",snapshot.tm_hour,snapshot.tm_min,
                  snapshot.tm_sec,station_short[secondStation],field);
  }
}

void loop() {
  flushRadioLogs();
  // WiFi.status() goes through the WiFi driver and loop() runs continuously
  // at high frequency - cache it once per pass rather than calling it
  // multiple times below for what's logically the same "is WiFi up right
  // now" question.
  bool wifiConnectedNow = (WiFi.status() == WL_CONNECTED);

  // Check WiFi connection periodically
  if (ap_mode == false && (millis() - last_wifi_check) > WIFI_CONNECT_CHECK_INTERVAL) {
    last_wifi_check = millis();
    checkWiFiConnection();
  }

  if (ntpSyncEvent) {
    ntpSyncEvent = false;
    configureAdaptiveNtp();
  }

  // WiFi power management: in Scheduled/power-save mode, turns the radio
  // off between sync windows. Safe to call every loop() pass - it
  // internally rate-limits itself.
  updateWifiPowerManagement();

  // Bluetooth watch synchronization runs independently of Wi-Fi state.
  serviceBluetoothSync();

  // Flush any pending config change to flash once things have settled
  // (see saveConfig()/writeConfigNow() for why this is debounced).
  if (configDirty && (millis() - configDirtyBecause) >= CONFIG_SAVE_DEBOUNCE_MS) {
    configDirty = false;
    configDirtyBecause = millis();
    writeConfigNow();
  }

  // Onboard LED as a WiFi/AP status indicator (non-blocking - millis()
  // based, no delay()):
  //   - Solid ON : connected to WiFi (normal operation)
  //   - Blinking : AP (configuration) mode, or STA mode not yet connected
  //                (actively trying)
  //   - Off      : Scheduled power-save mode, intentionally sleeping
  //                between sync windows - not an error state, so it's
  //                visually distinct from the "trying to connect" blink.
  bool deliberatelyAsleep = (wifiPowerMode == WIFI_POWER_SCHEDULED) && !wifiRadioEnabled && !ap_mode;
  bool wifiUp = (!ap_mode) && wifiConnectedNow;
  if (deliberatelyAsleep) {
    if (onboardLedState) { onboardLedState = false; digitalWrite(PIN_ONBOARD_LED, LOW); }
  } else if (wifiUp) {
    if (!onboardLedState) { onboardLedState = true; digitalWrite(PIN_ONBOARD_LED, HIGH); }
  } else if (millis() - last_led_blink >= 500) {
    last_led_blink = millis();
    onboardLedState = !onboardLedState;
    digitalWrite(PIN_ONBOARD_LED, onboardLedState ? HIGH : LOW);
  }

  // Handle web server requests (in both AP mode and STA mode)
  if (ap_mode || wifiConnectedNow) {
    server.handleClient();
  }

  yield();// feed watchdog
}


//...................................................................
void starttimer(void)
{
  if (istimerstarted) stoptimer();

  ampc = 0;
  tssec = 0;

  // Clear any stale notification count left over from before the timer was
  // stopped, so the radio task doesn't "catch up" on ticks that never
  // actually happened in hardware.
  if (radioTaskHandle != NULL) {
    xTaskNotifyStateClear(radioTaskHandle);
    ulTaskNotifyValueClear(radioTaskHandle, 0xFFFFFFFF);
  }

  // Use a 1 MHz hardware-timer tick and generate the 1 kHz service
  // interrupt with a 1000-tick alarm.  A direct 1 kHz timer clock would
  // require an 80,000 divider on an 80 MHz APB clock, exceeding the
  // ESP32 hardware timer divider range.
  tm0 = timerBegin(1000000);
  if (tm0 == NULL) {
    Serial.println("ERROR: Failed to create 1 MHz hardware timer");
    return;
  }
  timerAttachInterrupt(tm0, &onTimer);
  timerAlarm(tm0, 1000, true, 0);

  istimerstarted = 1;
}

void stoptimer(void)
{
  if (tm0 != NULL) {
    timerDetachInterrupt(tm0);
    timerEnd(tm0);
    tm0 = NULL;
  }

  if (carrierReady) ledcWrite(PIN_RADIO, 0);
  istimerstarted = 0;
}

// Called every 0.1s (see radioTask()) to update the actual RF carrier duty
// to match this instant's envelope value: txEnvelope[current second][which
// 0.1s slot]. State 1 = full carrier, state 2 = reduced carrier (the
// station-specific switch below picks how much reduction). MSF has no
// case here deliberately, not by omission: MSF's envelope (see mb_msf())
// uses true on/off keying (0 = carrier fully off, 1 = full carrier) rather
// than a continuous carrier with duty-modulated amplitude reduction like
// the other stations, so its envelope values are never 2 - state 0 already
// falls through to duty=0 correctly via the initial value, and state 1
// takes the RF_DUTY_FULL branch above just like every other station.
void ampchange(void)
{
  if (!carrierReady || radioPaused || last_station < 0 || last_station >= NUM_STATIONS) {
    if (carrierReady) ledcWrite(PIN_RADIO, 0);
    ampmod = 0;
    digitalWrite(PIN_LED, LOW);
    return;
  }
  if (nowtm.tm_sec < 0 || nowtm.tm_sec >= 60 || tssec < 0 || tssec >= 10) return;
  uint8_t state = txEnvelope[nowtm.tm_sec][tssec];
  uint32_t duty = 0;

  if (state == 1) {
    duty = RF_DUTY_FULL;
  } else if (state == 2) {
    switch (last_station) {
      case SN_JJY_E:
      case SN_JJY_W: duty = RF_DUTY_JJY_REDUCED; break;
      case SN_WWVB:  duty = RF_DUTY_WWVB_REDUCED; break;
      case SN_DCF77:
      case SN_BSF:   duty = RF_DUTY_DCF_REDUCED; break;
      case SN_BPC:   duty = RF_DUTY_BPC_REDUCED; break;
      default:       duty = 0; break;
    }
  }

  ledcWrite(PIN_RADIO, duty);
  // User feedback represents the modulation envelope: full carrier is ON,
  // reduced/off carrier is OFF. RF duty itself remains exactly as encoded.
  ampmod = (state == 1);
  digitalWrite(PIN_LED, ampmod ? HIGH : LOW);
}


const char* stationEncodingName(int station)
{
  switch (station) {
    case SN_JJY_E:
    case SN_JJY_W: return "JJY pulse-width AM";
    case SN_WWVB:  return "WWVB pulse-width AM";
    case SN_DCF77: return "DCF77 reduced-carrier AM";
    case SN_BSF:   return "BSF experimental - no encoded time data";
    case SN_MSF:   return "MSF A/B OOK";
    case SN_BPC:   return "BPC 2-bit pulse-width";
    default:       return "Unknown";
  }
}

// Return a human-readable description of the information represented by the
// current transmitted second. This is diagnostic output only; it does not
// change the encoded signal.
const char* txFieldDescription(int station, int second)
{
  if (station == SN_BPC) {
    int s = second % 20;
    if (s == 0) return "Sending frame marker";
    if (s == 1) return "Sending block-start second";
    if (s == 3 || s == 4) return "Sending hour";
    if (s >= 5 && s <= 7) return "Sending minute";
    if (s == 8 || s == 9) return "Sending weekday";
    if (s == 10) return "Sending PM flag/parity";
    if (s == 11 || s == 12 || s == 13) return "Sending date";
    if (s == 14 || s == 15) return "Sending month";
    if (s >= 16 && s <= 18) return "Sending year";
    return "Sending status/parity";
  }

  if (station == SN_DCF77) {
    if (second == 0 || second == 59) return "Sending minute marker";
    if (second >= 17 && second <= 20) return "Sending time-zone/status";
    if (second >= 21 && second <= 28) return "Sending minute";
    if (second >= 29 && second <= 35) return "Sending hour";
    if (second >= 36 && second <= 57) return "Sending date";
    if (second == 58) return "Sending date parity";
    return "Sending marker/status";
  }

  if (station == SN_MSF) {
    if (second == 0) return "Sending minute marker";
    if (second >= 17 && second <= 24) return "Sending year";
    if (second >= 25 && second <= 29) return "Sending month";
    if (second >= 30 && second <= 38) return "Sending date";
    if (second >= 39 && second <= 44) return "Sending hour";
    if (second >= 45 && second <= 51) return "Sending minute";
    if (second >= 53 && second <= 58) return "Sending status/parity";
    return "Sending second marker";
  }

  if (station == SN_WWVB) {
    if (second == 0 || second == 9 || second == 19 ||
        second == 29 || second == 39 || second == 49 || second == 59)
      return "Sending position marker";
    if (second >= 1 && second <= 8) return "Sending minute";
    if (second >= 12 && second <= 19) return "Sending hour";
    if (second >= 22 && second <= 33) return "Sending day of year";
    if (second >= 45 && second <= 53) return "Sending year";
    if (second >= 54 && second <= 58) return "Sending status";
    return "Sending marker/status";
  }

  // JJY uses minute, hour, day-of-year, year and weekday fields.
  if (second == 0 || second == 9 || second == 19 ||
      second == 29 || second == 39 || second == 49 || second == 59)
    return "Sending position marker";
  if (second >= 1 && second <= 8) return "Sending minute";
  if (second >= 12 && second <= 19) return "Sending hour";
  if (second >= 22 && second <= 30) return "Sending day of year";
  if (second >= 41 && second <= 49) return "Sending year";
  if (second >= 50 && second <= 52) return "Sending weekday";
  if (second >= 53 && second <= 58) return "Sending status/parity";
  return "Sending marker/status";
}


void printPatternRepeatInfo(int station)
{
  if (station < 0 || station >= NUM_STATIONS) return;
  uint32_t hz = carrierFrequencyHz;
  uint32_t frameSeconds = (station == SN_BPC) ? 20 : 60;
  Serial.printf("PATTERN REPEAT: %s | encoding=%s | frequency=%lu Hz (%.3f kHz) | frame=%lus\n",
                station_names[station], stationEncodingName(station),
                (unsigned long)hz, hz / 1000.0, (unsigned long)frameSeconds);
}

// Switches the active station while the 1 kHz scheduler remains armed:
// silences the carrier, reconfigures LEDC to the station frequency, then
// regenerates the active frame. Called only by radioTask at runtime.
void setstation(int station)
{
  if (station < 0 || station >= NUM_STATIONS) return;

  // Only radioTask calls this at runtime; the 1 kHz timer stays armed.
  if (carrierReady) ledcWrite(PIN_RADIO, 0);

  const uint32_t frequencies[NUM_STATIONS] = {
    40000, 60000, 60000, 77500, 77500, 60000, 68500
  };
  carrierFrequencyHz = frequencies[station];

  // Arduino-ESP32 3.x expects the LEDC clock-source configuration enum here.
  // APB clock provides a stable 80 MHz source for the LF carrier PWM.
  static bool ledcClockConfigured = false;
  if (!ledcClockConfigured) {
    ledcClockConfigured = ledcSetClockSource(LEDC_USE_APB_CLK);
    if (!ledcClockConfigured) {
      Serial.println("ERROR: Could not select LEDC APB clock");
      return;
    }
  }

  bool ok;
  if (!carrierReady) {
    ok = ledcAttachChannel(PIN_RADIO, carrierFrequencyHz,
                           RF_PWM_RESOLUTION, RF_PWM_CHANNEL);
    carrierReady = ok;
  } else {
    ok = ledcChangeFrequency(PIN_RADIO, carrierFrequencyHz,
                             RF_PWM_RESOLUTION) != 0;
  }

  if (!ok) {
    // If a live frequency change failed, detach the stale channel so a later
    // station selection can make a clean ledcAttachChannel() attempt.
    if (carrierReady) ledcDetach(PIN_RADIO);
    carrierReady = false;
    Serial.printf("ERROR: LEDC could not configure %lu Hz\n",
                  (unsigned long)carrierFrequencyHz);
    return;
  }

  ledcWrite(PIN_RADIO, 0);
  last_station = station;
  makebitpattern = st_makebits[station];  // selects mb_jjy()/mb_wwvb()/mb_dcf()/mb_msf()/mb_bpc() for this station
  makebitpattern();
  ampchange();
  queuePatternLog(station);
}

//...................................................................
// makeup bit pattern for current date, hour:min

// Arduino-ESP32's newlib does not ship the IANA zoneinfo database, so
// setting TZ to an IANA name like "Asia/Tokyo" does NOT apply the correct
// UTC offset or DST rule - tzset() silently falls back to UTC when it can't
// parse the TZ string as a POSIX rule. To make the "Time zone" selector in
// the UI actually control both the displayed clock AND the transmitted
// time, each zone offered in the UI is mapped here to an equivalent POSIX
// TZ rule, which tzset()/localtime_r() parse natively (DST transitions
// included).
static bool validTimezoneName(const String &zoneName)
{
  return zoneName == "Australia/Brisbane" || zoneName == "Australia/Sydney" ||
         zoneName == "Asia/Tokyo" || zoneName == "Asia/Shanghai" ||
         zoneName == "Europe/London" || zoneName == "America/New_York" ||
         zoneName == "America/Los_Angeles" || zoneName == "UTC";
}

static String posixTzFor(const String &zoneName)
{
  if (zoneName == "Australia/Brisbane")  return "AEST-10";                                  // no DST
  if (zoneName == "Australia/Sydney")    return "AEST-10AEDT,M10.1.0/2,M4.1.0/3";
  if (zoneName == "Asia/Tokyo")          return "JST-9";                                    // no DST
  if (zoneName == "Asia/Shanghai")       return "CST-8";                                    // no DST
  if (zoneName == "Europe/London")       return "GMT0BST,M3.5.0/1,M10.5.0/2";
  if (zoneName == "America/New_York")    return "EST5EDT,M3.2.0/2,M11.1.0/2";
  if (zoneName == "America/Los_Angeles") return "PST8PDT,M3.2.0/2,M11.1.0/2";
  if (zoneName == "UTC")                 return "UTC0";
  return "UTC0";  // unknown zone: fall back safely rather than silently mis-timing every transmission
}

// Applies the configured time zone to the C library. Used both for the
// on-screen clock (getlocaltime()/nowtm) and for the time actually encoded
// into the radio signal (stationTime() below), so the two always agree.
static void applyTimezone(void)
{
  setenv("TZ", posixTzFor(timezone_name).c_str(), 1);
  tzset();
}

// The time encoded into the transmission is always the local time of the
// zone selected in the "Time zone" card, plus the user's "Transmission
// offset" (which is relative to THAT zone, not to UTC). This is
// deliberately the same for every station: switching between JJY, WWVB,
// DCF77, MSF or BPC changes only the bit-level FORMAT the time is encoded
// in, never which moment in time gets encoded.
//
// (JJY/BPC previously added their real-world stations' fixed civil-time
// offset - JST/CST - and DCF77/MSF previously computed German/UK DST via
// hand-rolled EU-rule math independent of the UI's "Time zone" selector.
// That made the transmitted time depend on which station was selected,
// which is exactly what should NOT happen: the "Time zone" card is now the
// single source of truth for what time is transmitted, for every format.)
// Computes the actual moment in time to encode into the radio frame:
// current UTC, optionally advanced by one minute (nextMinute - DCF77 and
// MSF transmit data for the UPCOMING minute, JJY/WWVB/BPC transmit the
// CURRENT one), plus the user's transmission offset, all converted to
// local civil time via the currently-configured TZ (see applyTimezone()).
// The station parameter is intentionally unused: per an earlier design
// change, which station/encoding is selected never changes WHICH moment
// gets transmitted, only how it's formatted into bits - every station
// transmits the same selected-timezone-plus-offset time.
static void stationTime(time_t utc, int station, bool nextMinute, struct tm &out)
{
  (void)station;  // encoding format no longer changes which time is used
  time_t tx = utc + (nextMinute ? 60 : 0);
  tx += (time_t)transmission_offset_minutes * 60;
  localtime_r(&tx, &out);  // honors the POSIX TZ rule set by applyTimezone(), including DST
}

// Zeroes both transmit buffers. Called at the start of every mb_*()
// encoder before it writes this minute's frame, so any bit position an
// encoder doesn't explicitly set (reserved/unused bits) is guaranteed to
// come out as 0 rather than leftover data from whichever station was
// selected previously.
static void clearTxFrame(void)
{
  memset(txSymbol, 0, sizeof(txSymbol));
  memset(txEnvelope, 0, sizeof(txEnvelope));
}

// Converts txSymbol[60] (already filled in by mb_jjy()) into the 0.1s-
// resolution envelope ampchange() actually drives onto the RF carrier.
// JJY pulse shape (verified against NICT's spec): a "0" bit is 0.8s at
// full carrier then 0.2s reduced; a "1" bit is 0.5s/0.5s; a marker (the
// seven required sync pulses at seconds 0,9,19,29,39,49,59) is 0.2s/0.8s.
// Envelope values: 1 = full carrier, 2 = reduced carrier (see ampchange()
// for how these map to actual PWM duty).
static void buildJjyEnvelope(void)
{
  for (int s = 0; s < 60; ++s) {
    int marker = (s == 0 || s == 9 || s == 19 || s == 29 || s == 39 || s == 49 || s == 59);
    int highTenths = marker ? 2 : (txSymbol[s] ? 5 : 8);
    for (int k = 0; k < 10; ++k)
      txEnvelope[s][k] = (k < highTenths) ? 1 : 2;
  }
}

// WWVB's equivalent of buildJjyEnvelope() - same marker positions and
// pulse-shape ratios as JJY, but WWVB's amplitude convention is inverted
// (the modulated/"reduced" portion of each pulse comes FIRST rather than
// last), hence lowTenths counting from the start of the second instead of
// highTenths counting the full-carrier portion.
static void buildWwvbEnvelope(void)
{
  for (int s = 0; s < 60; ++s) {
    int marker = (s == 0 || s == 9 || s == 19 || s == 29 || s == 39 || s == 49 || s == 59);
    int lowTenths = marker ? 8 : (txSymbol[s] ? 5 : 2);
    for (int k = 0; k < 10; ++k)
      txEnvelope[s][k] = (k < lowTenths) ? 2 : 1;
  }
}

// Shared BCD field encoder for the minute/hour/day-of-year fields that JJY
// and WWVB both lay out identically (verified independently against each
// station's own spec - the bit positions happen to coincide, this isn't an
// approximation). Writes MSB-first BCD digits via binarize(): minute tens/
// ones at bits 1-3/5-8, hour tens/ones at 12-13/15-18, day-of-year hundreds/
// tens/ones at 22-23/25-28/30-33. t.tm_yday is 0-indexed in C, so +1 gives
// the 1-based day-of-year both specs expect. Callers still need to fill in
// everything station-specific themselves (markers, parity, year, weekday,
// DST/leap-second flags) - this only covers the fields both stations share.
static void encodeCommon(const struct tm &t)
{
  binarize(t.tm_min / 10, 1, 3);
  binarize(t.tm_min % 10, 5, 4);
  binarize(t.tm_hour / 10, 12, 2);
  binarize(t.tm_hour % 10, 15, 4);
  int doy = t.tm_yday + 1;
  binarize(doy / 100, 22, 2);
  binarize((doy / 10) % 10, 25, 4);
  binarize(doy % 10, 30, 4);
}

void mb_jjy(void)
{
  // JJY LF standard (NICT):
  //   40 kHz (Fukushima) / 60 kHz (Hagane-yama)
  //   JST = UTC+9
  //   60 seconds/frame
  //   M/P markers = 0.2 s
  //   binary 0 = 0.8 s
  //   binary 1 = 0.5 s
  //   Minute field: 1..8, PA2: 37
  //   Hour field:   12..18, PA1: 36
  //   Day-of-year: 22..30
  //   Year: 41..48
  //   Weekday: 50..52
  //   LS1/LS2: 53/54
  //   SU1/SU2: 40/20
  //   ST1..ST6: 55..58
  //
  // This encoder intentionally transmits the ordinary time-code frame.
  // NICT replaces part of the ordinary frame with call-sign Morse at :15/:45.
  // This local receiver emulator intentionally keeps the ordinary frame continuous
  // because that is more useful for watch synchronization; it is not a literal JJY broadcast then.
  clearTxFrame();
  for (int s = 0; s < 60; ++s)
    txSymbol[s] = (s == 0 || s == 9 || s == 19 || s == 29 || s == 39 || s == 49 || s == 59) ? SP_M : SP_0;

  time_t utc; time(&utc);
  struct tm t;
  stationTime(utc, last_station, false, t);
  encodeCommon(t);
  // NICT JJY parity positions (confirmed against the authoritative NICT
  // table): PA1 = second 36, even parity over the hour field (positions
  // 12-18, 7 bits). PA2 = second 37, even parity over the minute field
  // (positions 1-8, 8 bits).
  //
  // A previous revision of this file moved these to positions 19/36,
  // apparently on the mistaken belief that 19 held a parity bit. Position
  // 19 is actually the P2 POSITION MARKER (0.2s pulse, part of the 7
  // required sync markers at seconds 0,9,19,29,39,49,59) - overwriting it
  // with a data bit destroyed a marker a real receiver depends on to stay
  // frame-synchronized. That revision also computed the minute parity over
  // only 7 bits (positions 1-7), silently excluding position 8 (the
  // minute-ones "1" weight bit) from the checksum. Both are fixed here.
  txSymbol[36] = parity(12, 7);
  txSymbol[37] = parity(1, 8);
  binarize((t.tm_year - 100) / 10, 41, 4);
  binarize((t.tm_year - 100) % 10, 45, 4);
  binarize(t.tm_wday, 50, 3);

  // JJY reserved/control bits:
  // 40 = SU2 (daylight-saving-time state), normally 0 in Japan.
  // 53 = LS1 (leap-second announcement), 54 = LS2 (insert/remove).
  // 55-58 = service interruption information; all zero during normal service.
  // No leap second is currently scheduled, so all of these remain zero.
  txSymbol[40] = 0;
  txSymbol[53] = 0;
  txSymbol[54] = 0;
  txSymbol[55] = 0;
  txSymbol[56] = 0;
  txSymbol[57] = 0;
  txSymbol[58] = 0;

  buildJjyEnvelope();
}

void mb_wwvb(void)
{
  clearTxFrame();
  for (int s = 0; s < 60; ++s)
    txSymbol[s] = (s == 0 || s == 9 || s == 19 || s == 29 || s == 39 || s == 49 || s == 59) ? SP_M : SP_0;

  time_t utc; time(&utc);
  struct tm t;
  // Previously used gmtime_r() directly, i.e. always transmitted raw UTC
  // regardless of the "Time zone" card. Now transmits the same
  // selected-timezone civil time as every other station.
  stationTime(utc, SN_WWVB, false, t);
  encodeCommon(t);
  binarize((t.tm_year - 100) / 10, 45, 4);
  binarize((t.tm_year - 100) % 10, 50, 4);

  // DST bit reflects whether the SELECTED transmission timezone is
  // currently observing daylight saving, not US Mountain Time specifically.
  // tm_isdst comes straight from localtime_r() using the POSIX TZ rule
  // applyTimezone() configured for the selected zone.
  bool dst = t.tm_isdst > 0;

  // WWVB legacy AM/PWM control bits.
  // 55 = leap-year indicator; 56 = leap-second warning.
  // 57/58 = DST state. UT1 correction (36-43) remains zero because ordinary
  // NTP does not provide UT1-UTC to this firmware.
  bool leapYear = ((t.tm_year + 1900) % 4 == 0 &&
                   ((t.tm_year + 1900) % 100 != 0 || (t.tm_year + 1900) % 400 == 0));
  txSymbol[55] = leapYear ? SP_1 : SP_0;
  txSymbol[56] = SP_0;
  txSymbol[57] = dst ? SP_1 : SP_0;
  txSymbol[58] = dst ? SP_1 : SP_0;

  // DUT1 sign (bits 36-38) must be the pattern 101 (positive) or 010
  // (negative) per spec - an all-zero pattern is not a valid sign code.
  // Since ordinary NTP doesn't supply UT1-UTC to this firmware, DUT1 is
  // fixed at a nominal +0.0s (magnitude bits 40-43 stay zero).
  txSymbol[36] = SP_1;
  txSymbol[37] = SP_0;
  txSymbol[38] = SP_1;

  buildWwvbEnvelope();
}

void mb_dcf(void)
{
  clearTxFrame();
  time_t utc; time(&utc);
  struct tm t;
  stationTime(utc, SN_DCF77, true, t);

  // CET/CEST bit reflects the selected transmission timezone's own DST
  // state (tm_isdst from stationTime()'s localtime_r() call), not a
  // hand-rolled EU-only DST calculation. For a non-European zone this just
  // means the flag tracks that zone's DST, which is the correct behaviour
  // now that station selection never changes which time is transmitted.
  bool dst = t.tm_isdst > 0;

  // DCF77 transmits the following minute. Bits 1-14 are operational/public-warning
  // data outside the scope of this emulator and remain zero.
  txSymbol[15] = 0;
  txSymbol[16] = 0;
  // Z1 (bit 17) / Z2 (bit 18) time-zone bits, per PTB spec: Z1=1 indicates
  // CEST (DST) in effect; Z2=1 indicates CET (standard time) in effect.
  // (Z1,Z2)=(0,1) -> CET (winter); (1,0) -> CEST (summer).
  // A previous revision had these both swapped AND inverted (assigning CET
  // to bit 17 and CEST to bit 18, backwards from spec, and with the wrong
  // polarity), which would have told any real receiver the opposite
  // zone/DST state from what was actually being transmitted.
  txSymbol[17] = dst ? 1 : 0; // Z1: CEST
  txSymbol[18] = dst ? 0 : 1; // Z2: CET
  txSymbol[19] = 0;           // No leap-second announcement available from POSIX NTP
  txSymbol[20] = 1;           // Start of time information

  rbcdize(t.tm_min, 21, 7);
  txSymbol[28] = parity(21, 7);
  rbcdize(t.tm_hour, 29, 6);
  txSymbol[35] = parity(29, 6);
  rbcdize(t.tm_mday, 36, 6);
  int isoDow = t.tm_wday == 0 ? 7 : t.tm_wday;
  rbinarize(isoDow, 42, 3);
  rbcdize(t.tm_mon + 1, 45, 5);
  rbcdize(t.tm_year - 100, 50, 8);
  txSymbol[58] = parity(36, 22);

  for (int s = 0; s < 59; ++s) {
    int reduction = (s == 20) ? 2 : (txSymbol[s] ? 2 : 1);
    for (int k = 0; k < 10; ++k)
      txEnvelope[s][k] = (k < reduction) ? 2 : 1;
  }
  // DCF77 second 59 is the minute marker: no carrier reduction is emitted
  // during that second in the normal frame, so the envelope remains full.
  for (int k = 0; k < 10; ++k) txEnvelope[59][k] = 1;
}

void mb_bsf(void)
{
  clearTxFrame();
  for (int s = 0; s < 60; ++s)
    for (int k = 0; k < 10; ++k) txEnvelope[s][k] = 1;
}


void mb_msf(void)
{
  clearTxFrame();

  time_t utc; time(&utc);
  struct tm t;
  stationTime(utc, SN_MSF, true, t);

  // DST bit (B58) reflects the selected transmission timezone's own DST
  // state rather than a hardcoded UK-only calculation.
  bool dst = t.tm_isdst > 0;

  // MSF encodes the following UK civil-time minute.
  // Each second has two 100 ms data slots: A at 100-200 ms and B at 200-300 ms.
  // Logic 0 is carrier ON; logic 1 is carrier OFF.
  uint8_t A[60] = {0};
  uint8_t B[60] = {0};

  auto setBcdMsb = [](uint8_t *dstBits, int value, int pos, int len) {
    int p = pos + len - 1;
    int remaining = len;
    while (remaining > 0) {
      int n = remaining >= 4 ? 4 : remaining;
      int digit = value % 10;
      for (int i = 0; i < n; ++i) {
        dstBits[p - i] = digit & 1;
        digit >>= 1;
      }
      value /= 10;
      p -= n;
      remaining -= n;
    }
  };

  // MSF field allocation from NPL:
  // A17-A24 year, A25-A29 month, A30-A35 day, A36-A38 weekday,
  // A39-A44 hour, A45-A51 minute.
  setBcdMsb(A, t.tm_year - 100, 17, 8);
  setBcdMsb(A, t.tm_mon + 1, 25, 5);
  setBcdMsb(A, t.tm_mday, 30, 6);
  int dow = t.tm_wday; // NPL: Sunday=0 ... Saturday=6.
  A[36] = (dow >> 2) & 1;
  A[37] = (dow >> 1) & 1;
  A[38] = dow & 1;
  setBcdMsb(A, t.tm_hour, 39, 6);
  setBcdMsb(A, t.tm_min, 45, 7);

  // DUT1 is not available from ordinary NTP time, so A/B DUT1 fields remain zero.
  // NPL specifies odd parity in B54-B57.
  auto oddParityBit = [](uint8_t *a, int first, int last) -> uint8_t {
    int ones = 0;
    for (int i = first; i <= last; ++i) ones += a[i] ? 1 : 0;
    return (ones & 1) ? 0 : 1;
  };
  B[54] = oddParityBit(A, 17, 24);
  B[55] = oddParityBit(A, 25, 35);
  B[56] = oddParityBit(A, 36, 38);
  B[57] = oddParityBit(A, 39, 51);
  B[58] = dst ? 1 : 0;
  B[53] = 0;

  // Fixed A-channel sync pattern: per NPL's spec, A53 through A58 are
  // PERMANENTLY set to 1 (with A52 and A59 fixed at 0, already satisfied
  // since A[] defaults to zero and is never written there). Together this
  // forms the fixed bit sequence 0,1,1,1,1,1,1,0 across A52-A59, which
  // never occurs elsewhere in the A channel and gives receivers a second,
  // independent way to confirm the second-00 minute marker rather than
  // relying solely on the 500ms marker pulse. This was previously left at
  // the default 0 - a real receiver checking for this pattern would not
  // have been able to use it to confirm frame sync.
  for (int i = 53; i <= 58; ++i) A[i] = 1;

  // Second 00 is the 500 ms minute marker.
  for (int k = 0; k < 10; ++k) txEnvelope[0][k] = (k < 5) ? 0 : 1;

  for (int s = 1; s < 60; ++s) {
    txEnvelope[s][0] = 0;              // mandatory 100 ms second marker
    txEnvelope[s][1] = A[s] ? 0 : 1;   // bit A
    txEnvelope[s][2] = B[s] ? 0 : 1;   // bit B
    for (int k = 3; k < 10; ++k) txEnvelope[s][k] = 1;
    txSymbol[s] = (A[s] << 1) | B[s];
  }
}

void mb_bpc(void)
{
  clearTxFrame();
  time_t utc; time(&utc);
  struct tm t;
  stationTime(utc, SN_BPC, false, t);

  int blockSecond = (t.tm_sec / 20) * 20;
  int hour12 = t.tm_hour % 12;
  int pm = t.tm_hour >= 12;
  int minute = t.tm_min;
  int day = t.tm_mday;
  int month = t.tm_mon + 1;
  int year = t.tm_year - 100;
  int dow = t.tm_wday == 0 ? 7 : t.tm_wday;

  uint8_t pair[20][2] = {};

  // BPC's exact bit layout is not officially published by NTSC/China (it
  // requires a commercial license); the assignments below are reconstructed
  // from the community-derived table on Wikipedia's "BPC (time signal)"
  // article, which cross-checks against an actual captured/decoded
  // waterfall recording rather than being purely theoretical. Treat this as
  // the best publicly available reference rather than an official spec.
  //
  // Verified per-second layout (block-relative seconds, MSbit/LSbit):
  //   01: 40,20  block-start second (00/20/40)   02: unused
  //   03-04: 8,4,2,1  hour-of-halfday (0-11)
  //   05-07: 32,16,8,4,2,1  minute (0-59, straight binary, not BCD)
  //   08: unused,4   09: 2,1        -> weekday (4,2,1 = 1-7, Mon=1..Sun=7)
  //   10: PM flag,P1(even parity over seconds 01-09)
  //   11: unused,16  12-13: 8,4,2,1 -> day of month (16,8,4,2,1 = 1-31)
  //   14-15: 8,4,2,1  month (1-12)
  //   16-18: 32,16,8,4,2,1  year (0-99, straight binary)
  //   19: 64(year MSB),P2(even parity over seconds 11-18)
  //
  // A previous revision of this encoder used a different, non-matching
  // layout: it placed the PM flag/P1 parity at second 1 instead of 10, put
  // the block-start-second field at seconds 10-11 instead of 1, never wrote
  // the weekday's weight-4 bit or the block-start field's low bit at all,
  // and - most seriously - never wrote the day-of-month's weight-1 (LSB)
  // bit, meaning every odd/even day pair (e.g. the 14th and 15th) would
  // have been transmitted identically. All of that is corrected here.
  int bsCode = blockSecond / 20; // 0, 1, or 2 -> encodes 00/20/40 as 2 bits
  pair[1][0] = (bsCode >> 1) & 1;
  pair[1][1] = bsCode & 1;
  pair[3][0] = (hour12 >> 3) & 1; pair[3][1] = (hour12 >> 2) & 1;
  pair[4][0] = (hour12 >> 1) & 1; pair[4][1] = hour12 & 1;
  pair[5][0] = (minute >> 5) & 1; pair[5][1] = (minute >> 4) & 1;
  pair[6][0] = (minute >> 3) & 1; pair[6][1] = (minute >> 2) & 1;
  pair[7][0] = (minute >> 1) & 1; pair[7][1] = minute & 1;
  pair[8][1] = (dow >> 2) & 1;
  pair[9][0] = (dow >> 1) & 1; pair[9][1] = dow & 1;
  pair[10][0] = pm;
  pair[11][1] = (day >> 4) & 1;
  pair[12][0] = (day >> 3) & 1; pair[12][1] = (day >> 2) & 1;
  pair[13][0] = (day >> 1) & 1; pair[13][1] = day & 1;
  pair[14][0] = (month >> 3) & 1; pair[14][1] = (month >> 2) & 1;
  pair[15][0] = (month >> 1) & 1; pair[15][1] = month & 1;
  pair[16][0] = (year >> 5) & 1; pair[16][1] = (year >> 4) & 1;
  pair[17][0] = (year >> 3) & 1; pair[17][1] = (year >> 2) & 1;
  pair[18][0] = (year >> 1) & 1; pair[18][1] = year & 1;

  int p1 = 0;
  for (int s = 1; s <= 9; ++s) p1 ^= pair[s][0] ^ pair[s][1];
  pair[10][1] = p1;

  int p2 = 0;
  for (int s = 11; s <= 18; ++s) p2 ^= pair[s][0] ^ pair[s][1];
  pair[19][0] = (year >> 6) & 1;
  pair[19][1] = p2;

  // Each 20-second block starts with an unmodulated second, then 100/200/300/400 ms
  // reduced-carrier symbols representing 00/01/10/11.
  for (int block = 0; block < 3; ++block) {
    int base = block * 20;
    for (int s = 0; s < 20; ++s) {
      int sec = base + s;
      if (s == 0) {
        for (int k = 0; k < 10; ++k) txEnvelope[sec][k] = 1;
        txSymbol[sec] = SP_M4;
      } else {
        int symbol = (pair[s][0] << 1) | pair[s][1];
        txSymbol[sec] = symbol;
        int reduced = symbol + 1;
        for (int k = 0; k < 10; ++k)
          txEnvelope[sec][k] = (k < reduced) ? 2 : 1;
      }
    }
  }
}

// Writes v as an MSB-first ("big-endian" bit order) binary value: the most
// significant bit lands at txSymbol[pos], the least significant at
// txSymbol[pos+len-1]. Used by JJY/WWVB for their weighted-digit fields
// (see encodeCommon()) where the highest-weight bit naturally comes first.
// (A previous revision's comment here said "little endian", which is
// backwards from the actual bit order produced - fixed.)
void
binarize(int v, int pos, int len)
{
  for (pos = pos + len - 1; 0 < len; pos--, len--) {
    txSymbol[pos] = (uint8_t)(v & 1);
    v >>= 1;
  }
  return;
}

// Writes v as an LSB-first ("little-endian" bit order) binary value: the
// least significant bit lands at txSymbol[pos], the most significant at
// txSymbol[pos+len-1]. Used by DCF77 (see mb_dcf()/rbcdize()), which
// transmits its BCD digits least-significant-bit-first per PTB's spec.
// (A previous revision's comment here said "(big endian)", backwards from
// the actual bit order produced - fixed.)
void
rbinarize(int v, int pos, int len)
{
  for ( ; 0 < len; pos++, len--) {
    txSymbol[pos] = (uint8_t)(v & 1);
    v >>= 1;
  }
  return;
}

// LSB-first BCD: splits v into decimal digits (ones digit first, each
// digit itself written LSB-first via rbinarize()), matching DCF77's actual
// on-air bit order. This is what mb_dcf() uses for all of its BCD fields
// (minute, hour, day, month, year).
void
rbcdize(int v, int pos, int len)
{
  int l;

  while (0 < len) {
    if (4 <= len) {
      l = 4;
    } else {
      l = len;
    }
    rbinarize(v % 10, pos, l);
    v = v / 10;
    pos = pos + l;
    len = len - l;
  }
  return;
}

// Computes even parity (the return value, XOR'd with the data, always
// yields an even total number of 1 bits) over txSymbol[pos..pos+len-1].
// Used for every station's parity/checksum bits: JJY's PA1/PA2, WWVB's
// (implicit, via its own checks), DCF77's P1/P2/P3, and MSF's B54-B57 -
// see each mb_*() function for exactly which span it covers and why, all
// individually verified against that station's own specification.
int
parity(int pos, int len)
{
  int s = 0;
  
  for (pos; 0 < len; pos++, len--) {
    s += txSymbol[pos];
  }
  return (s % 2);
}


//// calculate doy (day of year)/dow (day of week) from YY/MM/DD
//void
//setdoydow(void)
//{
//  int j0 = julian(tyear, 1, 1);      // new year day of this year
//  int j1 = julian(tyear, tmon, tday);
//  tdoy = j1 - j0 + 1; // 1..365/366
//  tdow = j1 % 7;      // 0..6
//  return;
//}
//
//// return julian date (? relative date from a day)
//// sunday is multiple of 7
//int
//julian(int y, int m, int d)
//{
//  if (m <= 2) {
//    m = m + 12;
//    y--;
//  }
//  return y * 1461 / 4 + (m + 1) * 153 / 5 + d + 6;
////  1461 / 4 == 365.25, 153 / 5 == 30.6
//}
//
//// increment tday-tmon-tyear, tdoy, tdow
//void
//incday(void)
//{
//  int year1 = tyear;   // year of next month
//  int mon1 = tmon + 1; // next month
//  if (12 < mon1) {
//    mon1 = 1;
//    year1++;
//  }
//  int day1 = tday + 1; // date# of tomorrow
//  if (julian(year1, mon1, 1) - julian(tyear, tmon, 1) < day1) {
//    tday = 1;  // date# exceeds # of date in this month
//    tmon = mon1;
//    tyear = year1;
//  } else {
//    tday = day1;
//  }
//  setdoydow(); // tdoy, tdow is updated from tyear-tmonth-tday
//  return;
//}

void
printbits60(void)
{
  Serial.print("\n");
  for (int i = 0; i < 60; i++) {
    Serial.print(txSymbol[i]);
  }
  Serial.print("\n");
  return;
}

// SNTP library callback, fired automatically every time a sync completes
// (see sntp_set_time_sync_notification_cb() in ntpstart()). Compares how
// far the wall clock had drifted from what it "should" say (based on the
// board's own monotonic timer) since the previous sync, and folds that
// into a smoothed drift estimate. Only sets a flag (ntpSyncEvent) rather
// than doing any real work itself, since this runs in SNTP's own context;
// the actual interval recalculation happens in loop() via
// configureAdaptiveNtp(), called when that flag is seen.
void onNtpSync(struct timeval *tv)
{
  uint64_t mono = (uint64_t)esp_timer_get_time();
  int64_t epochUs = (int64_t)tv->tv_sec * 1000000LL + tv->tv_usec;

  if (ntpLastMonoUs != 0) {
    uint64_t elapsed = mono - ntpLastMonoUs;
    if (elapsed > 30000000ULL) {
      int64_t expected = ntpLastEpochUs + (int64_t)elapsed;
      int64_t correction = epochUs - expected;
      double ppm = ((double)correction * 1000000.0) / (double)elapsed;

      portENTER_CRITICAL(&clockMux);
      ntpDriftPpm = (ntpDriftPpm == 0.0)
        ? ppm
        : ntpDriftPpm * (1.0 - NTP_DRIFT_EMA_ALPHA) + ppm * NTP_DRIFT_EMA_ALPHA;
      ntpDriftAbsSecPerHour = fabs(ntpDriftPpm) * 3600.0 / 1000000.0;
      portEXIT_CRITICAL(&clockMux);
    }
  }

  portENTER_CRITICAL(&clockMux);
  ntpLastMonoUs = mono;
  ntpLastEpochUs = epochUs;
  clockNtpEverSynced = true;
  ++clockNtpSyncCount;
  portEXIT_CRITICAL(&clockMux);
  ntpsync = 1;
  ntpSyncEvent = true;
}

// Recalculates ntpIntervalSec from the current drift estimate and applies
// it to the running SNTP client. Called from loop() shortly after each
// sync (see onNtpSync()/ntpSyncEvent). Larger measured drift -> shorter
// interval (resync sooner, before error can accumulate); smaller drift ->
// longer interval, up to NTP_MAX_INTERVAL_SEC.
void configureAdaptiveNtp(void)
{
  portENTER_CRITICAL(&clockMux);
  double samplePpm=ntpDriftPpm;
  portEXIT_CRITICAL(&clockMux);
  double drift = fabs(samplePpm) / 1000000.0;
  if (drift < 1e-9) {
    ntpIntervalSec = NTP_INITIAL_INTERVAL_SEC;
  } else {
    double seconds = NTP_ERROR_BUDGET_SEC / drift;
    if (seconds < NTP_MIN_INTERVAL_SEC) seconds = NTP_MIN_INTERVAL_SEC;
    if (seconds > NTP_MAX_INTERVAL_SEC) seconds = NTP_MAX_INTERVAL_SEC;
    ntpIntervalSec = (uint32_t)seconds;
  }

  sntp_set_sync_interval(ntpIntervalSec * 1000UL);
  sntp_restart();

}

void ntpstart(void)
{
  // Full WiFi-connect + NTP-sync sequence: connects to the configured SSID
  // (blocking, up to ~10s), then configures and waits for a first NTP fix
  // (blocking, up to another ~20s). Called once at boot, and again by
  // updateWifiPowerManagement() every time it wakes the radio for a
  // scheduled sync window. Safe to call repeatedly - each call fully
  // reconfigures SNTP and re-applies the timezone, so it behaves the same
  // whether it's the first call after boot or the fifth call of the day.
  Serial.print("Attempting to connect to Network named: ");
  Serial.println(ssid);
  wifi_connect_start=millis();
  WiFi.begin(ssid, passwd);

  for (int i = 0; i < 20 && WiFi.status() != WL_CONNECTED; ++i) {
    Serial.print(".");
    delay(500);
  }
  if (WiFi.status() != WL_CONNECTED) {
    ntpsync = 0;
    Serial.println("\nWiFi connection failed");
    return;
  }

  sntp_set_time_sync_notification_cb(onNtpSync);
  // IMMED avoids calling the time trusted while an SNTP slew is still ongoing.
  sntp_set_sync_mode(SNTP_SYNC_MODE_IMMED);

  // configTzTime() configures SNTP with the selected POSIX TZ rule directly.
  // When NTP is restarted later by Scheduled Wi-Fi power management, pause
  // radioTask first so setenv()/tzset() cannot race localtime() while a frame
  // is being generated. At boot radioTask does not exist yet, so no pause is
  // needed.
  bool pausedForTimeConfig = false;
  if (radioTaskHandle != NULL) {
    if (!radioSetPaused(true)) {
      ntpsync = 0;
      Serial.println("\nERROR: Could not pause RF for NTP/timezone configuration");
      return;
    }
    pausedForTimeConfig = true;
  }

  String tzRule = posixTzFor(timezone_name);
  configTzTime(tzRule.c_str(), "pool.ntp.org", "time.nist.gov");

  if (pausedForTimeConfig) {
    if (!radioSetPaused(false)) {
      ntpsync = 0;
      Serial.println("\nERROR: Could not resume RF after NTP/timezone configuration");
      return;
    }
  }
  radioRequestRefresh();
  sntp_set_sync_interval(NTP_INITIAL_INTERVAL_SEC * 1000UL);

  struct tm ntpProbe = {};
  for (int i = 0; i < 20 && !getLocalTime(&ntpProbe, 1000); ++i) {
    Serial.print(".");
  }

  if (getLocalTime(&ntpProbe, 1000)) {
    ntpsync = 1;
    Serial.println("\nNTP synchronized");
  } else {
    ntpsync = 0;
    Serial.println("\nNTP synchronization failed");
  }
}

// Cleanly shuts down networking: stops the SNTP client, disconnects WiFi,
// and powers the radio off entirely (WIFI_OFF, not just disconnected - this
// actually powers down the WiFi hardware for real power savings). Used by
// updateWifiPowerManagement() to end a scheduled sync window in Power-save
// mode.
void
ntpstop(void)
{
  // Wi-Fi sleep does not invalidate a previously synchronized holdover clock.
  esp_sntp_stop();
  if (webServerStarted) { server.stop(); webServerStarted=false; }
  WiFi.disconnect(true);
  WiFi.mode(WIFI_OFF);
}


void
setlocaltime(void)
{
  time_t nowtime = mktime(&nowtm) /*+ TZ */;
  struct timeval tv = {
    .tv_sec = nowtime
  };
  settimeofday(&tv, NULL);
  getlocaltime(); // to make wday/yday
}


void
getlocaltime(void)
{
  // Deliberately NOT using the Arduino-ESP32 getLocalTime() helper here: it
  // silently blocks the caller for up to 5 seconds if system time has not
  // yet been set (e.g. before the first successful NTP reply). Since this
  // function is called once per second from the high-priority radio task,
  // any such stall would freeze the transmitted time code and the RF
  // envelope for seconds at a time. time()/localtime_r() never block and
  // honour the TZ environment variable set via setenv()/tzset(), which is
  // all we need once the timezone has been applied in setup().
  time_t nowtime;
  time(&nowtime);
  localtime_r(&nowtime, &nowtm);
}

//...................................................................
// New functions for web UI and configuration

// Flash-wear mitigation #2: uses LittleFS rather than SPIFFS. SPIFFS is
// deprecated by Espressif for exactly the reasons relevant here - it has
// weaker wear-leveling than LittleFS, and a write interrupted by power loss
// (e.g. someone unplugs the board mid-save) can corrupt the whole file
// rather than just losing the in-progress write. LittleFS is a drop-in
// replacement in modern Arduino-ESP32 with the same File/open()/read API
// used below, so no other code needed to change.

//...................................................................
// GW-BX5600 BLE protocol implementation

static bool btWatchNameMatches(int protocol, const String &advertisedName) {
  String name = advertisedName;
  name.toUpperCase();
  // Some GW-BX5600 advertisements have no complete local name. Retain the
  // original MIP discovery behaviour in that case; Standard/Analogue require
  // positive model identification before a time packet is ever written.
  if (!name.length()) return protocol == BT_PROTOCOL_BX5600_MIP;
  if (protocol == BT_PROTOCOL_BX5600_MIP) return name.indexOf("GW-BX5600") >= 0;
  if (protocol == BT_PROTOCOL_STANDARD) {
    const char *models[] = {"GW-B5600", "GMW-B5000", "GA-B2100", "DW-B5600",
                            "GM-B2100", "GST-B500", "MSG-B100", "G-B001",
                            "MRG-B5000", "GCW-B5000", "ECB-10", "ECB-20", "ECB-30"};
    for (const char *model : models) if (name.indexOf(model) >= 0) return true;
    return false;
  }
  if (protocol == BT_PROTOCOL_ANALOGUE) {
    const char *models[] = {"MTG-B1000", "MTG-B3000", "MTG-B3100", "GST-B100"};
    for (const char *model : models) if (name.indexOf(model) >= 0) return true;
    return false;
  }
  return false;
}

class GShockScanCallbacks : public NimBLEScanCallbacks {
public:
  void onResult(const NimBLEAdvertisedDevice *advertisedDevice) override {
    if (!advertisedDevice || !btWindowActive || btBleBusy || btDiscoveryReady) return;
    if (!advertisedDevice->haveServiceUUID() ||
        !advertisedDevice->isAdvertisingService(NimBLEUUID(CASIO_ADVERTISEMENT_SERVICE))) return;

    String name = advertisedDevice->haveName() ? String(advertisedDevice->getName().c_str()) : "";
    if (!btWatchNameMatches(btActiveProtocol, name)) return;
    const String address = advertisedDevice->getAddress().toString().c_str();

    portENTER_CRITICAL(&btDiscoveryMux);
    bool expectedMatches = !btExpectedProfileAddress[0] ||
                           strcasecmp(btExpectedProfileAddress, address.c_str()) == 0;
    if (expectedMatches && !btDiscoveryReady) {
      strlcpy(btDiscoveredName, name.c_str(), sizeof(btDiscoveredName));
      strlcpy(btDiscoveredAddress, address.c_str(), sizeof(btDiscoveredAddress));
      btDiscoveredAddressType = advertisedDevice->getAddressType();
      btDiscoveryReady = true;
    }
    portEXIT_CRITICAL(&btDiscoveryMux);
  }
};

class GShockClientCallbacks : public NimBLEClientCallbacks {
public:
  void onConnect(NimBLEClient *client) override { Serial.println("BT: Casio watch connected"); }
  void onDisconnect(NimBLEClient *client, int reason) override {
    Serial.printf("BT: Casio watch disconnected (reason=%d)\n", reason);
  }
};
static GShockClientCallbacks gshockClientCallbacks;

static void gshockNotifyCallback(NimBLERemoteCharacteristic *characteristic,
                                 uint8_t *data, size_t length, bool isNotify) {
  (void)characteristic;
  (void)isNotify;
  if (!data || !length) return;
  portENTER_CRITICAL(&btResponseMux);
  // First packet has the response header; continuation packets need not.
  // Buffer bounds are strict: never pass silently truncated watch data back.
  if (btResponseActive && (btResponseLength != 0 || data[0] == btExpectedHeader)) {
    if (length > sizeof(btResponseBuffer) - btResponseLength) {
      btResponseOverflow = true;
      ++btResponseErrors;
      btResponseActive = false;
    } else {
      memcpy(btResponseBuffer + btResponseLength, data, length);
      btResponseLength += length;
      btLastFragmentMillis = millis();
      ++btNotifications;
    }
  }
  portEXIT_CRITICAL(&btResponseMux);
}

static void clearBtDiscovery(void) {
  portENTER_CRITICAL(&btDiscoveryMux);
  btDiscoveryReady = false;
  btDiscoveredName[0] = '\0';
  btDiscoveredAddress[0] = '\0';
  btDiscoveredAddressType = 0xFF;
  portEXIT_CRITICAL(&btDiscoveryMux);
}

static bool consumeBtDiscovery(String &name, String &address, uint8_t &addressType) {
  char nameCopy[sizeof(btDiscoveredName)];
  char addressCopy[sizeof(btDiscoveredAddress)];
  bool ready;
  portENTER_CRITICAL(&btDiscoveryMux);
  ready = btDiscoveryReady;
  if (ready) {
    memcpy(nameCopy, btDiscoveredName, sizeof(nameCopy));
    memcpy(addressCopy, btDiscoveredAddress, sizeof(addressCopy));
    addressType = btDiscoveredAddressType;
    btDiscoveryReady = false;
  }
  portEXIT_CRITICAL(&btDiscoveryMux);
  if (!ready) return false;
  nameCopy[sizeof(nameCopy)-1] = '\0';
  addressCopy[sizeof(addressCopy)-1] = '\0';
  name = nameCopy;
  address = addressCopy;
  return address.length() == 17;
}

static void cancelBtResponse(void) {
  portENTER_CRITICAL(&btResponseMux);
  btResponseActive = false;
  portEXIT_CRITICAL(&btResponseMux);
}

void initBluetoothSync(void) {
  if (btBleInitialized) return;
  NimBLEDevice::init("RadioClock G-Shock Server");
  btScan = NimBLEDevice::getScan();
  static GShockScanCallbacks scanCallbacks;
  btScan->setScanCallbacks(&scanCallbacks, false);
  btScan->setActiveScan(true);
  btScan->setInterval(80);
  btScan->setWindow(60);
  btScan->setMaxResults(0); // callbacks only; do not retain scan-result objects
  btBleInitialized = true;
  Serial.println("BT: NimBLE Casio time-only multi-protocol service ready");
}


void resetBluetoothDayIfNeeded(void) {
  time_t epoch;
  time(&epoch);
  struct tm day;
  localtime_r(&epoch, &day);
  btSyncDayComplete = false; // Informational: any watch profile delivered today.
  for (int i = 0; i < BT_WATCH_PROFILE_COUNT; ++i)
    if (btProfileDoneToday(i)) btSyncDayComplete = true;
}

static int btMinutesOfDay(const struct tm &t) {
  return t.tm_hour * 60 + t.tm_min;
}

bool bluetoothTimeSlotConflicts(int minuteOfDay) {
  if (full_time_tx) return true;
  for (int m = -BT_PREPARE_MINUTES; m <= BT_WINDOW_AFTER_MINUTES; ++m) {
    int test = minuteOfDay + m;
    while (test < 0) test += 1440;
    while (test >= 1440) test -= 1440;
    for (int i = 0; i < schedule_count; ++i) {
      if (schedules[i].end_min > schedules[i].start_min &&
          test >= schedules[i].start_min &&
          test < schedules[i].end_min) return true;
    }
  }
  return false;
}

void startBluetoothWindow(int slot) {
  if (btBleBusy || btWindowActive) return;
  if (slot >= 0) {
    btPairModeActive = false; // Scheduled sync always honours the learned binding.
    if (!btSyncEnabled[slot] || btProfileDoneToday(btSyncProfile[slot]) ||
        bluetoothTimeSlotConflicts(btSyncTimes[slot])) return;
    time_t scanEpoch=time(nullptr); struct tm scanLocal; localtime_r(&scanEpoch,&scanLocal);
    btSlotAttemptYear[slot]=scanLocal.tm_year+1900;
    btSlotAttemptYday[slot]=scanLocal.tm_yday;
    btSyncActiveSlot = slot;
    btActiveProtocol = btSyncProtocol[slot];
    btActiveProfile = btSyncProfile[slot];
  } else {
    btSyncActiveSlot = -1;
    btActiveProtocol = btManualProtocol;
    btActiveProfile = btManualProfile;
  }
  btLastWatchAddress = "";
  btLastWatchAddressType = 0xFF;
  clearBtDiscovery();
  portENTER_CRITICAL(&btDiscoveryMux);
  if (!btPairModeActive && btProfileAddress[btActiveProfile].length() == 17)
    strlcpy(btExpectedProfileAddress, btProfileAddress[btActiveProfile].c_str(), sizeof(btExpectedProfileAddress));
  else
    btExpectedProfileAddress[0] = '\0'; // Pair mode accepts a new matching watch.
  portEXIT_CRITICAL(&btDiscoveryMux);
  btWindowActive = true;
  int remainingMinutes = BT_PREPARE_MINUTES+BT_WINDOW_AFTER_MINUTES+2;
  if (slot>=0) {
    time_t epoch=time(nullptr); struct tm t; localtime_r(&epoch,&t);
    int start=btSyncTimes[slot]-BT_PREPARE_MINUTES;
    if (start<0) start+=1440;
    int elapsed=(btMinutesOfDay(t)-start+1440)%1440;
    if (elapsed<remainingMinutes) remainingMinutes-=elapsed;
  }
  btWindowEndMillis = millis()+(unsigned long)remainingMinutes*60000UL;
  if (WiFi.status() == WL_CONNECTED) {
    sntp_restart();
    Serial.println("BT: NTP synchronization requested before watch connection");
  }
  Serial.printf("BT: %s for watch using %s protocol\n",
                btPairModeActive ? "pairing/waiting" : "waiting",
                btProtocolName(btActiveProtocol));
}

void stopBluetoothWindow(void) {
  btWindowActive = false;
  btSyncActiveSlot = -1;
  if (btScan && btScan->isScanning()) btScan->stop();
  clearBtDiscovery();
  btPairModeActive = false;
}

// Arm notification reception BEFORE sending the BLE request; otherwise a fast
// response can arrive while writeValue() is still returning and be discarded.
static void prepareBtResponse(uint8_t header) {
  portENTER_CRITICAL(&btResponseMux);
  btResponseActive = false;
  btExpectedHeader = header;
  btResponseLength = 0;
  btResponseOverflow = false;
  btLastFragmentMillis = millis();
  btResponseActive = true;
  portEXIT_CRITICAL(&btResponseMux);
}

// Dynamic response assembly: first fragment identifies the request; collect
// continuations until an idle gap, with a minimum size and hard overflow guard.
static bool waitBt(size_t minimum) {
  uint32_t started = millis();
  while (millis() - started < BT_REQUEST_TIMEOUT_MS) {
    portENTER_CRITICAL(&btResponseMux);
    size_t n = btResponseLength;
    unsigned long last = btLastFragmentMillis;
    bool overflow = btResponseOverflow;
    portEXIT_CRITICAL(&btResponseMux);
    if (overflow) { cancelBtResponse(); return false; }
    if (n >= minimum && millis() - last >= 300UL) {
      cancelBtResponse();
      return true;
    }
    delay(5);
  }
  cancelBtResponse();
  ++btResponseErrors;
  return false;
}

static size_t copyBt(uint8_t *dst, size_t maxLen) {
  portENTER_CRITICAL(&btResponseMux);
  size_t n = btResponseLength < maxLen ? btResponseLength : maxLen;
  memcpy(dst, btResponseBuffer, n);
  portEXIT_CRITICAL(&btResponseMux);
  return n;
}

static bool writeBt(NimBLERemoteCharacteristic *c, const uint8_t *d, size_t n) {
  if (!c) return false;
  bool delivered = c->writeValue(d, n, true);
  if (delivered) ++btWriteAcknowledgements;
  return delivered;
}

static void disconnectGShock(void) {
  if (btClient) {
    if (btClient->isConnected()) btClient->disconnect();
    NimBLEDevice::deleteClient(btClient);
    btClient = nullptr;
  }
  btService = nullptr;
  btSpRequest = nullptr;
  btSpData = nullptr;
  btSetChar = nullptr;
  btBleBusy = false;
}

static bool connectGShock(int protocol) {
  if (!btLastWatchAddress.length()) return false;
  btBleBusy = true;
  btClient = NimBLEDevice::createClient();
  ++btConnectionAttempts;
  if (!btClient) { btBleBusy=false; Serial.println("BT: NimBLE client allocation failed"); return false; }
  btClient->setClientCallbacks(&gshockClientCallbacks, false);
  btClient->setConnectTimeout(5000);
  NimBLEAddress peer(std::string(btLastWatchAddress.c_str()), btLastWatchAddressType);
  if (!btClient->connect(peer)) {
    Serial.println("BT: connection failed");
    disconnectGShock();
    return false;
  }
  btService = btClient->getService(NimBLEUUID(CASIO_WATCH_FEATURES_SERVICE));
  if (!btService) {
    Serial.println("BT: Casio feature service not found");
    disconnectGShock();
    return false;
  }
  btSetChar = btService->getCharacteristic(NimBLEUUID(CASIO_SET_CHAR));
  if (!btSetChar || !btSetChar->canWrite()) {
    Serial.println("BT: required writable Casio time characteristic missing");
    disconnectGShock();
    return false;
  }
  // Only the BX5600 MIP path needs SP request/response characteristics.
  // Subscribe before sending any request so a fast response cannot be lost.
  if (protocol == BT_PROTOCOL_BX5600_MIP) {
    btSpRequest = btService->getCharacteristic(NimBLEUUID(CASIO_SP_REQUEST_CHAR));
    btSpData = btService->getCharacteristic(NimBLEUUID(CASIO_SP_DATA_CHAR));
    if (!btSpRequest || !btSpData || !btSpRequest->canWrite() || !btSpData->canWrite()) {
      Serial.println("BT: GW-BX5600 SP characteristics missing/not writable");
      disconnectGShock();
      return false;
    }
    bool subscribed = false;
    const auto &chars = btService->getCharacteristics();
    for (auto *c : chars) {
      if (c && c->canNotify() && c->subscribe(true, gshockNotifyCallback, true)) subscribed = true;
    }
    if (!subscribed) {
      Serial.println("BT: no notifiable Casio response characteristic could be subscribed");
      disconnectGShock();
      return false;
    }
  }
  return true;
}

static size_t bxRequest(const uint8_t *req, size_t reqLen, uint8_t header,
                        size_t minimum, uint8_t *out, size_t maxOut) {
  prepareBtResponse(header);
  if (!writeBt(btSpRequest, req, reqLen)) {
    cancelBtResponse();
    ++btResponseErrors;
    return 0;
  }
  if (!waitBt(minimum)) return 0;
  size_t len = copyBt(out, maxOut);
  if (len < minimum || len > maxOut || out[0] != header) {
    ++btResponseErrors;
    return 0;
  }
  return len;
}

bool performGShockBX5600Sync(void) {
  if (!connectGShock(BT_PROTOCOL_BX5600_MIP)) return false;
  uint8_t r[BT_RESPONSE_CAPACITY];
  bool ok = false;

  do {
    const uint8_t req1[] = {0x05,0x1D,0x00,0x1D,0x00,0x24,0x00,0x24,0x01,0x24,0x02};
    size_t n1 = bxRequest(req1, sizeof(req1), 0x05, 101, r, sizeof(r));
    if (!n1) break;
    r[0] = 0x02;
    if (!writeBt(btSpData, r, n1)) break;

    const uint8_t req2[] = {0x03,0x1E,0x00,0x1E,0x00,0x1E,0x00};
    size_t n2 = bxRequest(req2, sizeof(req2), 0x03, 28, r, sizeof(r));
    if (!n2) break;
    r[0] = 0x06;
    if (!writeBt(btSpData, r, n2)) break;

    uint8_t req3[13] = {0x06};
    for (int i = 0; i < 6; ++i) {
      int idx = (i / 2) + ((i % 2) ? 6 : 0);
      req3[1 + i * 2] = 0x1F;
      req3[2 + i * 2] = (uint8_t)idx;
    }
    size_t n3 = bxRequest(req3, sizeof(req3), 0x06, 133, r, sizeof(r));
    if (!n3) break;
    if (!writeBt(btSpData, r, n3)) break;

    struct timeval tv;
    gettimeofday(&tv, nullptr);
    time_t epoch = tv.tv_sec;
    struct tm local;
    localtime_r(&epoch, &local);
    int year = local.tm_year + 1900;
    uint8_t tc[11] = {
      0x09,(uint8_t)(year&255),(uint8_t)((year>>8)&255),
      (uint8_t)(local.tm_mon+1),(uint8_t)local.tm_mday,
      (uint8_t)local.tm_hour,(uint8_t)local.tm_min,(uint8_t)local.tm_sec,
      (uint8_t)(local.tm_wday==0?7:local.tm_wday),
      (uint8_t)((tv.tv_usec/1000UL*256UL)/1000UL),0x01
    };
    if (!writeBt(btSetChar, tc, sizeof(tc))) break;

    ok = true;
    btDeliveryEvidence = "ATT write acknowledged; watch display unverified";
    Serial.printf("BT: GW-BX5600 time command delivered %04d-%02d-%02d %02d:%02d:%02d\n",
                  year, local.tm_mon+1, local.tm_mday,
                  local.tm_hour, local.tm_min, local.tm_sec);
  } while (false);

  disconnectGShock();
  return ok;
}

bool performCasioStandardTimeSync(int protocol) {
  if (protocol != BT_PROTOCOL_STANDARD && protocol != BT_PROTOCOL_ANALOGUE) return false;
  if (!connectGShock(protocol)) return false;
  struct timeval tv;
  gettimeofday(&tv, nullptr);
  time_t epoch = tv.tv_sec;
  struct tm local;
  localtime_r(&epoch, &local);
  int year = local.tm_year + 1900;
  const uint8_t tc[10] = {
    0x09, (uint8_t)(year & 255), (uint8_t)((year >> 8) & 255),
    (uint8_t)(local.tm_mon + 1), (uint8_t)local.tm_mday,
    (uint8_t)local.tm_hour, (uint8_t)local.tm_min, (uint8_t)local.tm_sec,
    (uint8_t)local.tm_wday, 0x01
  };
  bool ok = writeBt(btSetChar, tc, sizeof(tc));
  if (ok) btDeliveryEvidence = "ATT write acknowledged; watch display unverified";
  if (ok) Serial.printf("BT: %s time write acknowledged, %04d-%02d-%02d %02d:%02d:%02d\n",
                        btProtocolName(protocol), year, local.tm_mon + 1, local.tm_mday,
                        local.tm_hour, local.tm_min, local.tm_sec);
  disconnectGShock();
  return ok;
}

bool attemptBluetoothSync(void) {
  if (full_time_tx) {
    btLastSyncStatus = "Blocked: full-time radio transmission";
    return false;
  }
  if (!clockTrusted()) {
    btLastSyncStatus = "Blocked: NTP clock not trusted; awaiting a confirmed SNTP update";
    return false;
  }
  if (!radioSetPaused(true)) {
    btLastSyncStatus="Blocked: could not pause RF safely";
    return false;
  }
  const int protocol = btActiveProtocol;
  Serial.printf("BT: connecting with %s time-only protocol\n", btProtocolName(protocol));
  bool ok = (protocol == BT_PROTOCOL_BX5600_MIP)
              ? performGShockBX5600Sync() : performCasioStandardTimeSync(protocol);
  radioSetPaused(false);
  if (ok) {
    time_t syncEpoch=time(nullptr); struct tm syncLocal; localtime_r(&syncEpoch,&syncLocal);
    btSuccessYear[protocol] = syncLocal.tm_year + 1900;
    btSuccessYday[protocol] = syncLocal.tm_yday;
    btProfileSuccessYear[btActiveProfile] = syncLocal.tm_year + 1900;
    btProfileSuccessYday[btActiveProfile] = syncLocal.tm_yday;
    if (btPairModeActive || !btProfileAddress[btActiveProfile].length()) {
      btProfileAddress[btActiveProfile] = btLastWatchAddress;
      btProfileName[btActiveProfile] = btLastWatchName;
    }
    btSyncDayComplete = true;
    if (protocol == BT_PROTOCOL_BX5600_MIP) {
      btSyncLastYear = btSuccessYear[protocol];
      btSyncLastYday = btSuccessYday[protocol];
    }
    char d[16]; strftime(d,sizeof(d),"%Y-%m-%d",&syncLocal);
    btLastSyncDate = d;
    btLastSyncStatus = String("Watch ") + (btActiveProfile+1) + ": " + btProtocolName(protocol) + " - time write delivered (watch unverified)";
    saveConfig();
  } else {
    btLastSyncStatus = String(btProtocolName(protocol)) + " - sync attempt failed";
  }
  return ok;
}

void serviceBluetoothSync(void) {
  if (!btBleInitialized) initBluetoothSync();
  resetBluetoothDayIfNeeded();

  if (btPairRequested && !btBleBusy) {
    btPairRequested = false;
    btManualSyncRequested = false;
    btPairModeActive = true;
    btLastWatchAddress = "";
    btLastSyncStatus = String("Pairing Watch ") + (btManualProfile + 1) +
                       ": waiting for " + btProtocolName(btManualProtocol);
    startBluetoothWindow(-1);
  } else if (btManualSyncRequested && !btBleBusy) {
    btManualSyncRequested = false;
    btPairModeActive = false;
    btLastWatchAddress = "";
    startBluetoothWindow(-1);
  }

  if (!btWindowActive && !full_time_tx) {
    time_t scanEpoch=time(nullptr); struct tm scanLocal; localtime_r(&scanEpoch,&scanLocal);
    int nm = btMinutesOfDay(scanLocal);
    for (int i = 0; i < BT_SYNC_SLOT_COUNT; ++i) {
      if (!btSyncEnabled[i] || btProfileDoneToday(btSyncProfile[i])) continue;
      int prep = btSyncTimes[i] - BT_PREPARE_MINUTES;
      if (prep < 0) prep += 1440;
      if ((nm==prep || nm==(prep+1)%1440) &&
          !(btSlotAttemptYear[i]==scanLocal.tm_year+1900 && btSlotAttemptYday[i]==scanLocal.tm_yday)) {
        startBluetoothWindow(i);
        break;
      }
    }
  }

  if (btWindowActive && !btBleBusy) {
    if ((long)(millis() - btWindowEndMillis) >= 0) {
      stopBluetoothWindow();
      btLastSyncStatus = String(btProtocolName(btActiveProtocol)) + " - no watch connection";
      return;
    }

    String discoveredName, discoveredAddress;
    uint8_t discoveredType = 0xFF;
    if (consumeBtDiscovery(discoveredName, discoveredAddress, discoveredType)) {
      if (btScan && btScan->isScanning()) btScan->stop();
      btLastWatchName = discoveredName;
      btLastWatchAddress = discoveredAddress;
      btLastWatchAddressType = discoveredType;
      btWindowActive = false;
      bool ok = attemptBluetoothSync();
      if (!ok) {
        btLastWatchAddress = "";
        clearBtDiscovery();
        btWindowActive = true;
      } else {
        stopBluetoothWindow();
      }
      return;
    }

    if (btScan && !btScan->isScanning()) {
      if (!btScan->start(BT_SCAN_SLICE_MS, false, true)) {
        btLastSyncStatus = "Bluetooth scan start failed";
      }
    }
  }
}


void initFilesystem(void)
{
  if (!LittleFS.begin(true)) {
    Serial.println("LittleFS Mount Failed");
    return;
  }
  Serial.println("LittleFS Mounted Successfully");
}

void loadConfig(void)
{
  File configFile = LittleFS.open(CONFIG_FILE, "r");
  if (!configFile) {
    strcpy(ssid, ""); strcpy(passwd, "");
    timezone_name = DEFAULT_TZ_NAME;
    full_time_tx = false;
    wifiPowerMode = WIFI_POWER_ALWAYS_ON;
    return;
  }
  configFile.readStringUntil('\n').toCharArray(ssid, sizeof(ssid));
  configFile.readStringUntil('\n').toCharArray(passwd, sizeof(passwd));
  String tz = configFile.readStringUntil('\n'); tz.trim();

  // Accept old numeric configurations as well as the new IANA timezone names.
  if (tz == "32400") timezone_name = "Asia/Tokyo";
  else if (tz == "36000") timezone_name = "Australia/Brisbane";
  else if (tz == "39600") timezone_name = "Australia/Sydney";
  else if (tz == "28800") timezone_name = "Asia/Shanghai";
  else if (tz == "0") timezone_name = "Europe/London";
  else if (tz == "-18000") timezone_name = "America/New_York";
  else if (tz == "-28800") timezone_name = "America/Los_Angeles";
  else if (tz.length()) timezone_name = tz;
  else timezone_name = DEFAULT_TZ_NAME;
  // A hand-edited/corrupt legacy config must not leave the UI showing one
  // zone while posixTzFor() silently falls back to another.
  if (!validTimezoneName(timezone_name)) {
    Serial.println("Unsupported stored timezone; reverting to default");
    timezone_name = DEFAULT_TZ_NAME;
  }

  String tx = configFile.readStringUntil('\n'); tx.trim();
  full_time_tx = (tx == "1" || tx.equalsIgnoreCase("true"));

  String fs = configFile.readStringUntil('\n'); fs.trim();
  if (fs.length()) full_time_station = fs.toInt();
  if (full_time_station < SN_JJY_E || full_time_station > SN_BPC) full_time_station = SN_JJY_E;

  // Optional sixth configuration line. Zero preserves the official station time.
  String tso = configFile.readStringUntil('\n'); tso.trim();
  if (tso.length()) transmission_offset_minutes = tso.toInt();
  if (transmission_offset_minutes < -720 || transmission_offset_minutes > 840)
    transmission_offset_minutes = 0;

  // Optional seventh configuration line: WiFi power mode (0=Always On,
  // 1=Scheduled/power-save). Missing or unparsable defaults to Always On,
  // so existing configs without this line behave exactly as before.
  String wpm = configFile.readStringUntil('\n'); wpm.trim();
  wifiPowerMode = wpm.length() ? wpm.toInt() : WIFI_POWER_ALWAYS_ON;
  if (wifiPowerMode != WIFI_POWER_ALWAYS_ON && wifiPowerMode != WIFI_POWER_SCHEDULED)
    wifiPowerMode = WIFI_POWER_ALWAYS_ON;
  // Optional Bluetooth settings. Missing lines retain the Casio defaults.
  for (int i = 0; i < BT_SYNC_SLOT_COUNT; ++i) {
    String line = configFile.readStringUntil('\n'); line.trim();
    if (line.length()) btSyncEnabled[i] = (line == "1" || line.equalsIgnoreCase("true"));
  }
  String bty = configFile.readStringUntil('\n'); bty.trim();
  if (bty.length()) btSyncLastYear = bty.toInt();
  String btd = configFile.readStringUntil('\n'); btd.trim();
  if (btd.length()) btSyncLastYday = btd.toInt();
  String bts = configFile.readStringUntil('\n'); bts.trim();
  if (bts.length()) btLastSyncDate = bts;

  // Older V2.9 multi-protocol fields, kept in their original position.
  // Existing installations default every slot and the manual button to BX5600.
  for (int i = 0; i < BT_SYNC_SLOT_COUNT; ++i) {
    String p = configFile.readStringUntil('\n'); p.trim();
    if (p.length() && validBtProtocol(p.toInt())) btSyncProtocol[i] = (uint8_t)p.toInt();
  }
  String mp = configFile.readStringUntil('\n'); mp.trim();
  if (mp.length() && validBtProtocol(mp.toInt())) btManualProtocol = (uint8_t)mp.toInt();
  // Legacy files could have today's year/day persisted by a normal config
  // save even when no sync occurred. Trust the legacy completion fields only
  // if their calendar date agrees with the stored last-success date.
  int oldYear = 0, oldMonth = 0, oldDay = 0;
  if (sscanf(btLastSyncDate.c_str(), "%d-%d-%d", &oldYear, &oldMonth, &oldDay) == 3 &&
      oldYear >= 2020 && oldMonth >= 1 && oldMonth <= 12 && oldDay >= 1 && oldDay <= 31) {
    struct tm completed = {};
    completed.tm_year = oldYear - 1900;
    completed.tm_mon = oldMonth - 1;
    completed.tm_mday = oldDay;
    completed.tm_hour = 12;
    completed.tm_isdst = -1;
    mktime(&completed);
    if (oldYear == btSyncLastYear && completed.tm_yday == btSyncLastYday) {
      btSuccessYear[BT_PROTOCOL_BX5600_MIP] = btSyncLastYear;
      btSuccessYday[BT_PROTOCOL_BX5600_MIP] = btSyncLastYday;
    }
  }
  for (int p = BT_PROTOCOL_STANDARD; p < BT_PROTOCOL_COUNT; ++p) {
    String yearLine = configFile.readStringUntil('\n'); yearLine.trim();
    String dayLine = configFile.readStringUntil('\n'); dayLine.trim();
    if (yearLine.length()) btSuccessYear[p] = yearLine.toInt();
    if (dayLine.length()) btSuccessYday[p] = dayLine.toInt();
  }

  // Reliability-pass appended fields: slot times, watch-profile selection, independent
  // completion flags and learned addresses/names. Older files end here.
  for (int i=0;i<BT_SYNC_SLOT_COUNT;++i) {
    String v=configFile.readStringUntil('\n'); v.trim();
    if (v.length()) { int m=v.toInt(); if (m>=0 && m<1440) btSyncTimes[i]=m; }
  }
  for (int i=0;i<BT_SYNC_SLOT_COUNT;++i) {
    String v=configFile.readStringUntil('\n'); v.trim();
    if (v.length()) { int p=v.toInt(); if (p>=0 && p<BT_WATCH_PROFILE_COUNT) btSyncProfile[i]=p; }
  }
  String manual=configFile.readStringUntil('\n'); manual.trim();
  if (manual.length() && manual.toInt()>=0 && manual.toInt()<BT_WATCH_PROFILE_COUNT)
    btManualProfile=(uint8_t)manual.toInt();
  for (int i=0;i<BT_WATCH_PROFILE_COUNT;++i) {
    String y=configFile.readStringUntil('\n'); y.trim();
    String d=configFile.readStringUntil('\n'); d.trim();
    if (y.length() && d.length()) { btProfileSuccessYear[i]=y.toInt(); btProfileSuccessYday[i]=d.toInt(); }
  }
  for (int i=0;i<BT_WATCH_PROFILE_COUNT;++i) {
    String a=configFile.readStringUntil('\n'); a.trim();
    if (a.length()==17) btProfileAddress[i]=a;
  }
  for (int i=0;i<BT_WATCH_PROFILE_COUNT;++i) {
    String n=configFile.readStringUntil('\n'); n.trim(); n.replace("\r","");
    if (n.length()<48) btProfileName[i]=n;
  }
  // One-time V2.9 completion migration (existing four times all use Watch 1).
  if (btProfileSuccessYear[0]<0 && btSuccessYear[BT_PROTOCOL_BX5600_MIP]>=2020) {
    btProfileSuccessYear[0]=btSuccessYear[BT_PROTOCOL_BX5600_MIP];
    btProfileSuccessYday[0]=btSuccessYday[BT_PROTOCOL_BX5600_MIP];
  }
  for (int i=0; ssid[i]; i++) if (ssid[i]=='\r'||ssid[i]=='\n') ssid[i]='\0';
  for (int i=0; passwd[i]; i++) if (passwd[i]=='\r'||passwd[i]=='\n') passwd[i]='\0';
  configFile.close();
  Serial.printf("Loaded config: SSID=%s, TZ=%s, Full TX=%s, WiFi mode=%s\n",
                ssid, timezone_name.c_str(), full_time_tx ? "ON":"OFF",
                wifiPowerMode == WIFI_POWER_SCHEDULED ? "Scheduled" : "Always on");
}

// Flash-wear mitigation #3: debounced config persistence. Several settings
// (timezone, transmission offset, full-time toggle, WiFi power mode) apply
// immediately on change and each POST unconditionally calls saveConfig() at
// the end of the handler. A person clicking around a few times a session is
// negligible wear, but nothing previously stopped a scripted/automated
// integration from calling the API rapidly and hammering flash with a full
// config rewrite on every single change. saveConfig() now just marks the
// config dirty; the actual flash write is coalesced by writeConfigNow()
// (called from loop()) after CONFIG_SAVE_DEBOUNCE_MS of no further changes.
// In-memory settings still take effect the instant they're changed (nothing
// here delays behavior) - only the flash write itself is debounced, so the
// only real cost of this is that a change made within the debounce window
// of a power loss could need to be re-applied after reboot.
// (CONFIG_SAVE_DEBOUNCE_MS/configDirty/configDirtyBecause are declared up
// near the other globals, above loop(), since loop() reads them directly
// and - unlike functions - plain variables/#defines aren't auto-forward-
// declared by the Arduino build system.)

void writeConfigNow(void)
{
  String blob;
  blob.reserve(700);
  auto line = [&](const String &v) { blob += v; blob += '\n'; };
  line(ssid); line(passwd); line(timezone_name);
  line(full_time_tx ? "1":"0"); line(String(full_time_station));
  line(String(transmission_offset_minutes)); line(String(wifiPowerMode));
  for (int i=0;i<BT_SYNC_SLOT_COUNT;++i) line(btSyncEnabled[i] ? "1":"0");
  line(String(btSyncLastYear)); line(String(btSyncLastYday)); line(btLastSyncDate);
  for (int i=0;i<BT_SYNC_SLOT_COUNT;++i) line(String((int)btSyncProtocol[i]));
  line(String((int)btManualProtocol));
  for (int i=BT_PROTOCOL_STANDARD;i<BT_PROTOCOL_COUNT;++i) {
    line(String(btSuccessYear[i])); line(String(btSuccessYday[i]));
  }
  for (int i=0;i<BT_SYNC_SLOT_COUNT;++i) line(String(btSyncTimes[i]));
  for (int i=0;i<BT_SYNC_SLOT_COUNT;++i) line(String((int)btSyncProfile[i]));
  line(String((int)btManualProfile));
  for (int i=0;i<BT_WATCH_PROFILE_COUNT;++i) {
    line(String(btProfileSuccessYear[i])); line(String(btProfileSuccessYday[i]));
  }
  for (int i=0;i<BT_WATCH_PROFILE_COUNT;++i) line(btProfileAddress[i]);
  for (int i=0;i<BT_WATCH_PROFILE_COUNT;++i) {
    String n=btProfileName[i]; n.replace("\r", ""); n.replace("\n", ""); line(n);
  }
  File f=LittleFS.open(CONFIG_TEMP_FILE,"w");
  if (!f) { Serial.println("Config save failed: temp open"); configDirty=true; return; }
  size_t written=f.print(blob); f.flush(); f.close();
  if (written!=blob.length() || !LittleFS.rename(CONFIG_TEMP_FILE,CONFIG_FILE)) {
    Serial.println("Config save failed: old file retained"); configDirty=true;
    return;
  }
  Serial.println("Config saved atomically");
}

void saveConfig(void)
{
  configDirty = true;
  configDirtyBecause = millis();
}

static bool validScheduleJson(JsonVariantConst v, TimeSchedule &out) {
  if (!v.is<JsonObjectConst>()) return false;
  JsonObjectConst o=v.as<JsonObjectConst>();
  if (!o["station"].is<int>() || !o["start"].is<int>() || !o["end"].is<int>()) return false;
  int st=o["station"].as<int>(), a=o["start"].as<int>(), b=o["end"].as<int>();
  if (st<0 || st>=NUM_STATIONS || a<0 || a>=1440 || b<=a || b>1440) return false;
  out.station=st; out.start_min=a; out.end_min=b; return true;
}
void normalizeBluetoothSlots() {
  bool changed=false;
  for (int i=0;i<BT_SYNC_SLOT_COUNT;++i) {
    bool earlierOverlap=false;
    for (int j=0;j<i;++j) if (btSyncEnabled[j] &&
        btCircularDistance(btSyncTimes[i],btSyncTimes[j]) <= BT_PREPARE_MINUTES+BT_WINDOW_AFTER_MINUTES+1)
      earlierOverlap=true;
    if (btSyncEnabled[i] && (bluetoothTimeSlotConflicts(btSyncTimes[i]) || earlierOverlap)) {
      btSyncEnabled[i]=false; changed=true;
    }
  }
  if (changed) { Serial.println("BT: conflicting automatic slots disabled"); saveConfig(); }
}
void loadSchedules(void)
{
  schedule_count=0;
  File f=LittleFS.open(STATION_CONFIG_FILE,"r");
  if (!f) {
    // Preserve original first-install JJY behaviour, now normalized against BLE.
    schedules[0]={SN_JJY_E,0,1440}; schedule_count=1;
    normalizeBluetoothSlots();
    Serial.println("No schedule file: default all-day JJY, conflicting Bluetooth disabled");
    return;
  }
  DynamicJsonDocument doc(8192);
  DeserializationError err=deserializeJson(doc,f); f.close();
  if (err || !doc.is<JsonArray>() || doc.as<JsonArray>().size()>MAX_SCHEDULES) {
    Serial.println("Invalid schedule: fail safe to RF-off until resaved");
    return;
  }
  JsonArray a=doc.as<JsonArray>();
  TimeSchedule candidate[MAX_SCHEDULES]; int count=0;
  for (JsonVariant v:a) {
    if (!validScheduleJson(v.as<JsonVariantConst>(),candidate[count])) {
      Serial.println("Invalid schedule entry: RF-off fail safe");
      return;
    }
    ++count;
  }
  memcpy(schedules,candidate,count*sizeof(TimeSchedule));
  schedule_count=count; // [] intentionally means no radio schedule, RF remains off.
  normalizeBluetoothSlots();
  Serial.printf("Loaded %d validated schedules\n",schedule_count);
}

bool saveSchedules(void)
{
  File f=LittleFS.open(SCHEDULE_TEMP_FILE,"w");
  if (!f) { Serial.println("Schedule save failed: temp open"); return false; }
  DynamicJsonDocument doc(8192);
  JsonArray a=doc.to<JsonArray>();
  for (int i=0;i<schedule_count;++i) {
    JsonObject o=a.createNestedObject();
    o["station"]=schedules[i].station;
    o["start"]=schedules[i].start_min;
    o["end"]=schedules[i].end_min;
  }
  size_t expected=measureJson(doc),written=serializeJson(doc,f);
  f.flush(); f.close();
  if (expected!=written || !LittleFS.rename(SCHEDULE_TEMP_FILE,STATION_CONFIG_FILE)) {
    Serial.println("Schedule save failed: previous file retained"); return false;
  }
  normalizeBluetoothSlots();
  saveConfig();
  radioRequestRefresh();
  Serial.println("Schedules saved atomically"); return true;
}

void applyCurrentSchedule(void)
{
  // Never broadcast a bogus date from an unsynchronized power-on clock.
  // During holdover the conservative drift/error budget determines trust.
  if (!clockTrusted()) {
    applicable_count=0; current_schedule_index=-1;
    last_station=-1; makebitpattern=nullptr;
    if (carrierReady) ledcWrite(PIN_RADIO,0);
    digitalWrite(PIN_LED,LOW); ampmod=0;
    return;
  }
  // Full-time mode ignores schedules, but continues transmitting the
  // selected station's normal clock/time-code signal 24/7.
  if (full_time_tx) {
    applicable_count = 0;
    current_schedule_index = -1;
    if (last_station != full_time_station) {
      setstation(full_time_station);
    }
    return;
  }

  // Calculate current minute of day (0-1439)
  int current_min = nowtm.tm_hour * 60 + nowtm.tm_min;
  
  // Find all applicable schedules for current time
  applicable_count = 0;
  for (int i = 0; i < schedule_count; i++) {
    if (current_min >= schedules[i].start_min && 
        current_min < schedules[i].end_min) {
      applicable_schedules[applicable_count] = i;
      applicable_count++;
    }
  }
  
  int new_station = -1;  // No matching schedule means RF is OFF.
  
  if (applicable_count == 0) {
    // No matching scheduled period: stop RF, not a fallback transmission.
    current_schedule_index = -1;
  } else if (applicable_count == 1) {
    // Single schedule, use it
    current_schedule_index = 0;
    new_station = schedules[applicable_schedules[0]].station;
  } else {
    // Multiple schedules - rotate through them. The active set can shrink
    // between seconds; clamp immediately so a stale index can never select a
    // schedule that is no longer applicable.
    unsigned long now = millis();
    if (current_schedule_index < 0 || current_schedule_index >= applicable_count) {
      current_schedule_index = 0;
      last_rotation_time = now;
      // Schedule-rotation diagnostics are deferred; never print in radioTask.
    }
      // Serial.printf("now: %lu\n", now);
      // Serial.printf("last_rotation_time: %lu\n", last_rotation_time);
    // Check if it's time to rotate to next schedule
    if ((now - last_rotation_time) >= (ROTATION_INTERVAL_MINUTES * 60000UL)) {
      current_schedule_index++;

      if (current_schedule_index >= applicable_count) {
        current_schedule_index = 0;
      }
      last_rotation_time = now;
      // Station change is reported in the next queued pattern log.
    }
    
    new_station = schedules[applicable_schedules[current_schedule_index]].station;
  }
  
  // Change station if needed
  if (new_station != last_station) {
    if (new_station < 0) {
      last_station = -1;
      makebitpattern = nullptr;
      if (carrierReady) ledcWrite(PIN_RADIO, 0);
      digitalWrite(PIN_LED, LOW);
      ampmod = 0;
    } else {
      setstation(new_station);
    }
  }
}

// Returns true if, in Scheduled/power-save mode, WiFi should currently be
// powered on for a pre-transmission sync window.
//
// Schedule start times (schedules[i].start_min, minutes since local
// midnight) are compared directly against nowtm - which, per stationTime()/
// getlocaltime(), always reflects the currently SELECTED time zone. So a
// schedule set for "1:00" with Tokyo selected means 1:00 Tokyo time, not
// UTC or the device's own location - this was already true structurally
// once NTP setup was made timezone-safe, since nowtm and the
// schedule matching in applyCurrentSchedule() both key off the same
// zone-aware local clock. The wake-window check below uses that same clock.
bool shouldWifiBeOnForSchedule(void)
{
  // Bluetooth watch sync also needs Wi-Fi available during its short
  // preparation/connection window when Scheduled power-save is enabled.
  // This gives the BLE sync an opportunity to request a fresh NTP sync without
  // requiring a radio transmission schedule at the same time.
  if (!full_time_tx) {
    time_t epochNow=time(nullptr); struct tm wifiLocal; localtime_r(&epochNow,&wifiLocal);
    int current_min = wifiLocal.tm_hour * 60 + wifiLocal.tm_min;
    for (int i = 0; i < BT_SYNC_SLOT_COUNT; ++i) {
      if (!btSyncEnabled[i] || btProfileDoneToday(btSyncProfile[i])) continue;
      for (int d = -BT_PREPARE_MINUTES; d <= BT_WINDOW_AFTER_MINUTES; ++d) {
        int test = btSyncTimes[i] + d;
        while (test < 0) test += 1440;
        while (test >= 1440) test -= 1440;
        if (current_min == test) return true;
      }
    }
  }

  // Full-time transmission or no configured schedules -> there's no
  // discrete "next start time" to key off. Wake periodically instead so
  // the clock still gets an occasional NTP resync.
  if (full_time_tx || schedule_count == 0) {
    static unsigned long periodicWakeAnchor = 0;
    unsigned long now = millis();
    if (periodicWakeAnchor == 0) periodicWakeAnchor = now; // first check after boot
    unsigned long sinceAnchor = now - periodicWakeAnchor;
    if (sinceAnchor < WIFI_PERIODIC_WAKE_DURATION_MS) return true;
    if (sinceAnchor >= WIFI_PERIODIC_WAKE_INTERVAL_MS) periodicWakeAnchor = now;
    return false;
  }

  time_t epochNow=time(nullptr); struct tm wifiLocal; localtime_r(&epochNow,&wifiLocal);
  int current_min = wifiLocal.tm_hour * 60 + wifiLocal.tm_min;
  for (int i = 0; i < schedule_count; ++i) {
    int start = schedules[i].start_min;
    int lead = start - WIFI_PRE_SCHEDULE_LEAD_MIN;
    bool inWindow;
    if (lead >= 0) {
      inWindow = (current_min >= lead && current_min < start);
    } else {
      // Lead window wraps past local midnight.
      lead += 1440;
      inWindow = (current_min >= lead || current_min < start);
    }
    if (inWindow) return true;
  }
  return false;
}

// Called from loop() every few seconds when wifiPowerMode == WIFI_POWER_SCHEDULED.
// Turns the WiFi radio fully on/off to match shouldWifiBeOnForSchedule(),
// with a mandatory on-window for the first WIFI_BOOT_ON_DURATION_MS after
// boot so the device is always reachable to be configured. Never runs while
// in AP configuration mode.
void updateWifiPowerManagement(void)
{
  if (ap_mode) return;
  if (wifiPowerMode != WIFI_POWER_SCHEDULED) return;

  static unsigned long lastCheck = 0;
  unsigned long now = millis();
  if (now - lastCheck < 5000) return;
  lastCheck = now;

  bool wantOn = (now - bootMillis < WIFI_BOOT_ON_DURATION_MS) || shouldWifiBeOnForSchedule();

  if (wantOn && !wifiRadioEnabled) {
    Serial.println("WiFi power-save: waking radio for sync window");
    wifiRadioEnabled = true;
    ntpstart();
    if (WiFi.status() == WL_CONNECTED) {
      initWebServer();
      digitalWrite(PIN_ONBOARD_LED, HIGH);
    }
  } else if (!wantOn && wifiRadioEnabled) {
    Serial.println("WiFi power-save: sync window closed, powering down radio");
    wifiRadioEnabled = false;
    ntpstop(); // stops SNTP cleanly, then disconnects and powers off the radio
  }
}

void checkWiFiConnection(void)
{
  if (ap_mode) {
    return;  // Already in AP mode
  }
  // In Scheduled power-save mode, WiFi being disconnected while
  // wifiRadioEnabled is false is intentional - don't fight our own sleep
  // by trying to reconnect here.
  if (wifiPowerMode == WIFI_POWER_SCHEDULED && !wifiRadioEnabled) {
    return;
  }

  if (WiFi.status() == WL_CONNECTED) {
    wifi_connect_start=0;
    if (!webServerStarted) initWebServer();
    return;
  }
  // Check if WiFi is still connected
  if (WiFi.status() != WL_CONNECTED) {
    Serial.println("WiFi connection lost, attempting to reconnect...");
    if (wifi_connect_start==0) wifi_connect_start=millis();
    WiFi.reconnect();
  }
  
  // If connection takes too long, switch to AP mode
  if (WiFi.status() != WL_CONNECTED && wifi_connect_start &&
      (millis() - wifi_connect_start) > WIFI_CONNECT_TIMEOUT) {
    Serial.println("WiFi connection timeout, starting AP mode...");
    startAPMode();
  }
}

void startAPMode(void)
{
  radioSetPaused(true);  // Command radioTask to silence RF during AP setup
  ap_mode = true;
  if (webServerStarted) { server.stop(); webServerStarted=false; }
  WiFi.mode(WIFI_AP);
  // Use the WiFi MAC for the AP suffix (works on ESP32 and ESP32-C3).
  uint8_t mac[6];
  WiFi.macAddress(mac);
  char ap_name[32];
  snprintf(ap_name, sizeof(ap_name), "%s_%02X%02X%02X",
           DEVICENAME_PREFIX, mac[3], mac[4], mac[5]);
  
  WiFi.softAP(ap_name, "12345678");  // Open AP or with default password
  
  IPAddress IP = WiFi.softAPIP();
  Serial.printf("AP Mode started. SSID: %s, IP: %s\n", ap_name, IP.toString().c_str());
  
  initWebServer();
  Serial.println("Web server started");
}

void stopAPMode(void)
{
  ap_mode = false;
  if (webServerStarted) { server.stop(); webServerStarted=false; }
  WiFi.softAPdisconnect(true);
  // Resume STA mode web server after connecting to Wi-Fi.
  WiFi.mode(WIFI_STA);
  radioSetPaused(false);  // Resume radio via radioTask
  Serial.println("AP mode stopped, web server continues on WiFi");
}

String jsonQuoted(const String &value) {
  DynamicJsonDocument d(value.length() * 2 + 64);
  d.set(value);
  String j; serializeJson(d,j); return j;
}
void initWebServer(void)
{
  if (webServerStarted) return;
  if (!webRoutesRegistered) {
  // Register routes only once. Restart listening after Wi-Fi sleep/AP switch.
  // Serve index page
  server.on("/", HTTP_GET, []() {
    sendIndexPage();
  });
  
  // API endpoints
  server.on("/api/config", HTTP_GET, []() {
    String json = "{\"ssid\":" + jsonQuoted(String(ssid)) + ",\"timezone\":" +
                  jsonQuoted(timezone_name) + ",\"full_time_tx\":" +
                  String(full_time_tx ? "true" : "false") +
                  ",\"full_time_station\":" + String(full_time_station) +
                  ",\"transmission_offset_minutes\":" + String(transmission_offset_minutes) +
                  ",\"wifi_power_mode\":" + String(wifiPowerMode);
    json += ",\"bt_day_complete\":" + String(btSyncDayComplete ? "true" : "false");
    json += ",\"bt_manual_protocol\":" + String((int)btManualProtocol);
    json += ",\"bt_manual_profile\":" + String((int)btManualProfile);
    json += ",\"bt_active_protocol\":" + String((int)btActiveProtocol);
    json += ",\"bt_active_profile\":" + String((int)btActiveProfile);
    json += ",\"bt_last_sync_status\":\"" + btLastSyncStatus +
            "\",\"bt_last_sync_date\":\"" + btLastSyncDate + "\"";
    json += ",\"bt_times\":[";
    for (int i = 0; i < BT_SYNC_SLOT_COUNT; ++i) {
      if (i > 0) json += ",";
      json += "{\"minute\":" + String(btSyncTimes[i]) +
              ",\"enabled\":" + String(btSyncEnabled[i] ? "true" : "false") +
              ",\"protocol\":" + String((int)btSyncProtocol[i]) +
              ",\"profile\":" + String((int)btSyncProfile[i]) +
              ",\"done_today\":" + String(btProfileDoneToday(btSyncProfile[i]) ? "true" : "false") +
              ",\"conflict\":" + String((bluetoothTimeSlotConflicts(btSyncTimes[i]) || btOverlapsOtherEnabledSlot(i,btSyncTimes[i])) ? "true" : "false") + "}";
    }
    json += "],\"bt_profiles\":[";
    for (int i=0;i<BT_WATCH_PROFILE_COUNT;++i) {
      if (i) json += ",";
      json += "{\"id\":" + String(i) + ",\"bound\":" +
              String(btProfileAddress[i].length()?"true":"false") +
              ",\"done_today\":" + String(btProfileDoneToday(i)?"true":"false") + "}";
    }
    json += "]}";
    server.send(200, "application/json", json);
  });
  
  server.on("/api/config", HTTP_POST, []() {
    // Settings can be updated independently. Full-time TX therefore takes
    // effect immediately without requiring the Save settings button.
    bool wifiChanged = false;
    bool encodingChanged = false;

    if (server.hasArg("ssid")) {
      String requestedSsid = server.arg("ssid");
      if (requestedSsid.length() >= sizeof(ssid)) {
        server.send(400, "application/json", "{\"status\":\"error\",\"message\":\"SSID is too long\"}"); return;
      }
      if (requestedSsid != String(ssid)) {
        requestedSsid.toCharArray(ssid, sizeof(ssid));
        wifiChanged = true;
      }
    }
    if (server.hasArg("password") && server.arg("password").length()>0) {
      String requestedPassword = server.arg("password");
      if (requestedPassword.length() >= sizeof(passwd)) {
        server.send(400, "application/json", "{\"status\":\"error\",\"message\":\"Wi-Fi password is too long\"}"); return;
      }
      requestedPassword.toCharArray(passwd, sizeof(passwd));
      wifiChanged = true;
    }
    if (server.hasArg("timezone")) {
      String requestedZone = server.arg("timezone");
      if (!validTimezoneName(requestedZone)) {
        server.send(400, "application/json", "{\"status\":\"error\",\"message\":\"Unsupported time zone\"}"); return;
      }
      if (requestedZone != timezone_name) {
        if (!radioSetPaused(true)) {
          server.send(503, "application/json", "{\"status\":\"error\",\"message\":\"RF pause timed out\"}"); return;
        }
        timezone_name = requestedZone;
        applyTimezone();
        radioSetPaused(false);
        encodingChanged = true;
      }
    }
    if (server.hasArg("full_time_tx")) {
      String v = server.arg("full_time_tx");
      bool requestedFull = (v == "1" || v.equalsIgnoreCase("true"));
      if (requestedFull) {
        for (int i = 0; i < BT_SYNC_SLOT_COUNT; ++i) {
          if (btSyncEnabled[i]) {
            server.send(409, "application/json",
                        "{\"status\":\"error\",\"message\":\"Disable Bluetooth automatic sync before enabling full-time radio transmission\"}");
            return;
          }
        }
      }
      full_time_tx = requestedFull;
      encodingChanged = true;
    }
    if (server.hasArg("full_time_station")) {
      full_time_station = server.arg("full_time_station").toInt();
      if (full_time_station < SN_JJY_E || full_time_station > SN_BPC)
        full_time_station = SN_JJY_E;
      encodingChanged = true;
    }
    if (server.hasArg("transmission_offset_minutes")) {
      transmission_offset_minutes = server.arg("transmission_offset_minutes").toInt();
      if (transmission_offset_minutes < -720 || transmission_offset_minutes > 840)
        transmission_offset_minutes = 0;
      encodingChanged = true;
    }
    if (server.hasArg("wifi_power_mode")) {
      int m = server.arg("wifi_power_mode").toInt();
      wifiPowerMode = (m == WIFI_POWER_SCHEDULED) ? WIFI_POWER_SCHEDULED : WIFI_POWER_ALWAYS_ON;
      // No immediate WiFi action needed here: the request just arrived over
      // WiFi, so the radio is already on. updateWifiPowerManagement() in
      // loop() takes over the on/off decisions from this point onward.
      // (saveConfig() runs unconditionally below.)
    }

    if (server.hasArg("bt_manual_protocol")) {
      int p = server.arg("bt_manual_protocol").toInt();
      if (server.arg("bt_manual_protocol") != String(p) || !validBtProtocol(p) ||
          btBleBusy || btWindowActive || btManualSyncRequested || btPairRequested) {
        server.send(409, "application/json", "{\"status\":\"error\",\"message\":\"invalid protocol or Bluetooth window is active\"}");
        return;
      }
      btManualProtocol = (uint8_t)p;
      saveConfig();
      server.send(200, "application/json", "{\"status\":\"ok\"}");
      return;
    }
    if (server.hasArg("bt_manual_profile")) {
      int p=server.arg("bt_manual_profile").toInt();
      if (p<0 || p>=BT_WATCH_PROFILE_COUNT || btWindowActive || btBleBusy || btPairRequested) {
        server.send(409,"application/json","{\"status\":\"error\",\"message\":\"invalid/busy profile\"}");return;
      }
      btManualProfile=(uint8_t)p; saveConfig();
      server.send(200,"application/json","{\"status\":\"ok\"}");return;
    }
    if (server.hasArg("bt_rebind_profile")) {
      int p=server.arg("bt_rebind_profile").toInt();
      if (p<0 || p>=BT_WATCH_PROFILE_COUNT || btWindowActive || btBleBusy || btPairRequested) {
        server.send(409,"application/json","{\"status\":\"error\",\"message\":\"invalid/busy profile\"}");return;
      }
      btProfileAddress[p]=""; btProfileName[p]=""; saveConfig();
      server.send(200,"application/json","{\"status\":\"ok\",\"message\":\"Watch binding cleared. Resync to learn a new watch.\"}");return;
    }
    if (server.hasArg("bt_slot")) {
      int slot = server.arg("bt_slot").toInt();
      if (slot < 0 || slot >= BT_SYNC_SLOT_COUNT) {
        server.send(400, "application/json", "{\"status\":\"error\",\"message\":\"invalid Bluetooth slot\"}");
        return;
      }
      if (server.hasArg("bt_slot_time")) {
        String requested=server.arg("bt_slot_time");
        int m=requested.toInt();
        if (requested != String(m) || m<0 || m>=1440 || btWindowActive || btBleBusy ||
            bluetoothTimeSlotConflicts(m) || btOverlapsOtherEnabledSlot(slot,m)) {
          server.send(409,"application/json","{\"status\":\"error\",\"message\":\"Time invalid, busy, or overlaps a radio/Bluetooth window\"}"); return;
        }
        btSyncTimes[slot]=m; saveConfig();
        server.send(200,"application/json","{\"status\":\"ok\"}");return;
      }
      if (server.hasArg("bt_slot_profile")) {
        int p=server.arg("bt_slot_profile").toInt();
        if (p<0 || p>=BT_WATCH_PROFILE_COUNT || btBleBusy || btWindowActive) {
          server.send(409,"application/json","{\"status\":\"error\",\"message\":\"Invalid/busy watch profile\"}");return;
        }
        // One logical watch has one protocol across its enabled sync slots.
        for (int i=0;i<BT_SYNC_SLOT_COUNT;++i)
          if (i!=slot && btSyncEnabled[i] && btSyncProfile[i]==p &&
              btSyncProtocol[i]!=btSyncProtocol[slot]) {
            server.send(409,"application/json","{\"status\":\"error\",\"message\":\"Watch profile uses another protocol\"}");return;
          }
        btSyncProfile[slot]=p; saveConfig();
        server.send(200,"application/json","{\"status\":\"ok\"}");return;
      }
      if (server.hasArg("bt_slot_protocol")) {
        int p = server.arg("bt_slot_protocol").toInt();
        if (server.arg("bt_slot_protocol") != String(p) || !validBtProtocol(p) ||
            btBleBusy || btWindowActive) {
          server.send(409, "application/json", "{\"status\":\"error\",\"message\":\"invalid protocol or Bluetooth window is active\"}");
          return;
        }
        for (int i=0;i<BT_SYNC_SLOT_COUNT;++i)
          if (i!=slot && btSyncEnabled[i] && btSyncProfile[i]==btSyncProfile[slot] &&
              btSyncProtocol[i]!=p) {
            server.send(409,"application/json","{\"status\":\"error\",\"message\":\"Watch profile uses another protocol\"}");return;
          }
        btSyncProtocol[slot] = (uint8_t)p;
        saveConfig();
        server.send(200, "application/json", "{\"status\":\"ok\"}");
        return;
      }
      if (!server.hasArg("bt_slot_enabled")) {
        server.send(400, "application/json", "{\"status\":\"error\",\"message\":\"Bluetooth slot update missing enabled value\"}");
        return;
      }
      bool en = server.hasArg("bt_slot_enabled") &&
                (server.arg("bt_slot_enabled") == "1" ||
                 server.arg("bt_slot_enabled").equalsIgnoreCase("true"));
      if (en && btProfileDoneToday(btSyncProfile[slot])) {
        server.send(409, "application/json", "{\"status\":\"error\",\"message\":\"This watch protocol already synced today\"}");
        return;
      }
      if (en && (bluetoothTimeSlotConflicts(btSyncTimes[slot]) ||
                 btOverlapsOtherEnabledSlot(slot,btSyncTimes[slot]))) {
        server.send(409, "application/json",
                    "{\"status\":\"error\",\"message\":\"Bluetooth time conflicts with a radio transmission schedule\"}");
        return;
      }
      btSyncEnabled[slot] = en;
      saveConfig();
      server.send(200, "application/json", "{\"status\":\"ok\"}");
      return;
    }


    if (encodingChanged) {
      // Hand the actual regeneration off to radioTask (see
      // encodingRefreshRequested above) rather than touching
      // txSymbol[]/txEnvelope[] here, since this handler runs on the web
      // server task and those arrays are read by radioTask every 1 ms.
      // radioTask picks this up on its very next tick, so the transmitted
      // signal (and therefore the UI, which polls /api/status once a
      // second) reflects the change essentially immediately.
      radioRequestRefresh();
    } else {
      // Nothing encoding-related changed, but a schedule/station switch may
      // still be needed the ordinary way (e.g. re-evaluate full_time_tx
      // toggling off with no other field changed is covered above; this
      // branch only runs when only WiFi credentials were posted).
      radioRequestRefresh();
    }
    saveConfig();

    server.send(200, "application/json",
                String("{\"status\":\"ok\",\"full_time_tx\":") +
                (full_time_tx ? "true" : "false") +
                ",\"station\":" + String(last_station) + "}");

    // Only reconnect when Wi-Fi credentials were changed.
    if (wifiChanged) {
      Serial.printf("Connecting to WiFi: %s\n", ssid);
      WiFi.mode(WIFI_STA);
      wifi_connect_start=millis();
      WiFi.begin(ssid, passwd);
    }
  });

  server.on("/api/stations", HTTP_GET, []() {
    String json = "[";
    for (int i = 0; i < NUM_STATIONS; i++) {
      if (i > 0) json += ",";
      json += "{\"id\":" + String(i) + ",\"name\":\"" + String(station_names[i]) + "\",\"encoding\":\"" + String(stationEncodingName(i)) + "\"}";
    }
    json += "]";
    server.send(200, "application/json", json);
  });
  
  // Returns the full schedule list. Used by the UI's load() to populate the
  // "Transmission schedules" card.
  server.on("/api/schedules", HTTP_GET, []() {
    String json = "[";
    for (int i = 0; i < schedule_count; i++) {
      if (i > 0) json += ",";
      json += "{\"station\":" + String(schedules[i].station) +
              ",\"start\":" + String(schedules[i].start_min) +
              ",\"end\":" + String(schedules[i].end_min) + "}";
    }
    json += "]";
    server.send(200, "application/json", json);
  });
  
  // Adds a single schedule entry. NOTE: the bundled web UI never calls this
  // - saveSchedules() in the JS always POSTs the entire list to the plural
  // /api/schedules endpoint below instead, replacing everything at once.
  // Left in place as a simpler per-item option for any external script/
  // integration that might prefer it over resending the whole list, but if
  // you're looking for what the UI's "Save schedules" button actually
  // calls, that's the POST /api/schedules handler further down.
  server.on("/api/schedule", HTTP_POST, []() {
    DynamicJsonDocument doc(256);
    if (!server.hasArg("plain") || deserializeJson(doc,server.arg("plain"))) {
      server.send(400,"application/json","{\"status\":\"error\",\"message\":\"invalid JSON\"}"); return;
    }
    TimeSchedule next;
    if (!validScheduleJson(doc.as<JsonVariantConst>(),next) || schedule_count>=MAX_SCHEDULES) {
      server.send(400,"application/json","{\"status\":\"error\",\"message\":\"invalid schedule / limit reached\"}"); return;
    }
    if (!radioSetPaused(true)) { server.send(503,"application/json","{\"status\":\"error\",\"message\":\"RF pause timed out\"}"); return; }
    schedules[schedule_count++]=next;
    bool saved=saveSchedules();
    if (!saved) --schedule_count;
    radioSetPaused(false);
    if (!saved) { server.send(500,"application/json","{\"status\":\"error\"}"); return; }
    server.send(200,"application/json","{\"status\":\"ok\"}");
  });

  // Replaces the ENTIRE schedule list in one request - this is what the
  // UI's "Save schedules" button actually calls (see saveSchedules() in the
  // JS), sending every row currently shown, every time.
  server.on("/api/schedules", HTTP_POST, []() {
    if (!server.hasArg("plain") || server.arg("plain").length()>8192) {
      server.send(400,"application/json","{\"status\":\"error\",\"message\":\"missing/oversized JSON\"}"); return;
    }
    DynamicJsonDocument doc(8192);
    if (deserializeJson(doc,server.arg("plain")) || !doc.is<JsonArray>() ||
        doc.as<JsonArray>().size()>MAX_SCHEDULES) {
      server.send(400,"application/json","{\"status\":\"error\",\"message\":\"invalid schedule list\"}"); return;
    }
    TimeSchedule next[MAX_SCHEDULES]; int n=0;
    for (JsonVariant v:doc.as<JsonArray>()) {
      if (!validScheduleJson(v.as<JsonVariantConst>(),next[n])) {
        server.send(400,"application/json","{\"status\":\"error\",\"message\":\"invalid station or time range\"}"); return;
      }
      ++n;
    }
    if (!radioSetPaused(true)) { server.send(503,"application/json","{\"status\":\"error\",\"message\":\"RF pause timed out\"}"); return; }
    TimeSchedule previous[MAX_SCHEDULES]; memcpy(previous,schedules,sizeof(previous));
    int oldCount=schedule_count;
    memcpy(schedules,next,n*sizeof(TimeSchedule)); schedule_count=n;
    bool saved=saveSchedules();
    if (!saved) { memcpy(schedules,previous,sizeof(previous)); schedule_count=oldCount; }
    radioSetPaused(false);
    if (!saved) { server.send(500,"application/json","{\"status\":\"error\",\"message\":\"flash save failed\"}");return; }
    server.send(200,"application/json","{\"status\":\"ok\"}");
  });

  // Deletes a single schedule by index. Like the singular POST above, the
  // bundled UI doesn't call this either - it just removes the row locally
  // and resends the whole list via POST /api/schedules instead. Kept for
  // the same reason.
  server.on("/api/schedule", HTTP_DELETE, []() {
    if (server.hasArg("index")) {
      int idx = server.arg("index").toInt();
      if (idx >= 0 && idx < schedule_count) {
        if (!radioSetPaused(true)) { server.send(503,"application/json","{\"status\":\"error\",\"message\":\"RF pause timed out\"}"); return; }
        TimeSchedule previous[MAX_SCHEDULES]; memcpy(previous,schedules,sizeof(previous));
        int oldCount=schedule_count;
        for (int i = idx; i < schedule_count - 1; i++) schedules[i] = schedules[i + 1];
        --schedule_count;
        bool saved=saveSchedules();
        if (!saved) { memcpy(schedules,previous,sizeof(previous)); schedule_count=oldCount; }
        radioSetPaused(false);
        if (!saved) { server.send(500,"application/json","{\"status\":\"error\"}"); return; }
        server.send(200, "application/json", "{\"status\":\"ok\"}");
      } else {
        server.send(400, "application/json", "{\"status\":\"error\",\"message\":\"invalid index\"}");
      }
    } else {
      server.send(400, "application/json", "{\"error\":\"missing index\"}");
    }
  });
  
  // Primary status endpoint, polled once a second by the UI's tick(). Reports
  // both the plain local clock (time/date, in the selected timezone) and the
  // actual civil time currently being encoded into the radio signal
  // (tx_time) - these can differ by up to a minute for DCF77/MSF, which
  // transmit the UPCOMING minute rather than the current one (tx_next_minute
  // tells the UI which case it's in).
  server.on("/api/status", HTTP_GET, []() {
    // Build response with rotation information
    // Use the ESP32's configured IANA timezone for the displayed local time.
    time_t displayEpoch = time(nullptr);
    struct tm displayLocal;
    localtime_r(&displayEpoch, &displayLocal);
    char localTime[16];
    char localDate[16];
    strftime(localTime, sizeof(localTime), "%H:%M:%S", &displayLocal);
    strftime(localDate, sizeof(localDate), "%Y-%m-%d", &displayLocal);

    // Calculate exactly which civil time the active encoder is using.
    // DCF77 and MSF encode the following minute; the other current encoders
    // use the current minute/frame. The user's transmission offset is included.
    time_t utcNow;
    time(&utcNow);
    bool nextMinute = (last_station == SN_DCF77 || last_station == SN_MSF);
    struct tm txTm;
    stationTime(utcNow, last_station, nextMinute, txTm);
    char txTime[32];
    strftime(txTime, sizeof(txTime), "%Y-%m-%d %H:%M:%S", &txTm);

    // This handler is polled once a second by every open browser tab (see
    // tick() in the UI), making it the hottest of all the web handlers.
    // Reserving the String's capacity upfront avoids the repeated
    // grow-and-copy reallocations that would otherwise happen on nearly
    // every one of the += appends below - cheap to do, and removes
    // needless heap churn from a handler that runs continuously.
    String json;
    json.reserve(512);
    json = "{\"time\":\"" + String(localTime) + "\",\"date\":\"" + String(localDate) + "\"";
    json += ",\"timezone\":\"" + timezone_name + "\"";
    json += ",\"tx_time\":\"" + String(txTime) + "\"";
    
    // Add applicable schedules count for rotation display
    json += ",\"applicable_schedules\":[";
    for (int i = 0; i < applicable_count; i++) {
      if (i > 0) json += ",";
      json += String(applicable_schedules[i]);
    }
    json += "]";
    
    json += ",\"full_time_tx\":" + String(full_time_tx ? "true" : "false");
  json += ",\"ntp_interval\":" + String(ntpIntervalSec);
  json += ",\"ntp_drift_ppm\":" + String(ntpDriftPpm, 3);
    json += ",\"station\":" + String(last_station);
    json += ",\"radio_active\":" + String(last_station >= 0 && !radioPaused ? "true" : "false");
    json += ",\"tx_next_minute\":" + String(last_station >= 0 && nextMinute ? "true" : "false");
    json += ",\"bt_day_complete\":" + String(btSyncDayComplete ? "true" : "false");
    json += ",\"bt_manual_protocol\":" + String((int)btManualProtocol);
    json += ",\"bt_manual_profile\":" + String((int)btManualProfile);
    json += ",\"bt_active_protocol\":" + String((int)btActiveProtocol);
    json += ",\"bt_active_profile\":" + String((int)btActiveProfile);
    json += ",\"bt_last_sync_status\":\"" + btLastSyncStatus + "\"";
    json += ",\"bt_pairing\":" + String((btPairModeActive || btPairRequested) ? "true" : "false");
    json += ",\"bt_last_sync_date\":\"" + btLastSyncDate + "\"";
    json += ",\"bt_times\":[";
    for (int i = 0; i < BT_SYNC_SLOT_COUNT; ++i) {
      if (i > 0) json += ",";
      json += "{\"minute\":" + String(btSyncTimes[i]) +
              ",\"enabled\":" + String(btSyncEnabled[i] ? "true" : "false") +
              ",\"protocol\":" + String((int)btSyncProtocol[i]) +
              ",\"profile\":" + String((int)btSyncProfile[i]) +
              ",\"done_today\":" + String(btProfileDoneToday(btSyncProfile[i]) ? "true" : "false") +
              ",\"conflict\":" + String((bluetoothTimeSlotConflicts(btSyncTimes[i]) || btOverlapsOtherEnabledSlot(i,btSyncTimes[i])) ? "true" : "false") + "}";
    }
    json += "]";
    json += ",\"clock_state\":\"" + String(clockConfidence()) + "\"";
    json += ",\"firmware_version\":\"" + String(FIRMWARE_VERSION) + "\"";
    json += "}";
    server.send(200, "application/json", json);
  });
  
  server.on("/api/diagnostics", HTTP_GET, []() {
    DynamicJsonDocument d(2048);
    d["firmware"]=FIRMWARE_VERSION;
    d["uptime_sec"]=millis()/1000UL;
    d["heap_free"]=ESP.getFreeHeap();
    d["heap_min_free"]=ESP.getMinFreeHeap();
    d["clock_state"]=clockConfidence();
    d["ntp_age_sec"]=clockAgeSeconds()==UINT32_MAX?-1:(int32_t)clockAgeSeconds();
    d["ntp_sync_count"]=clockNtpSyncCount;
    d["clock_error_est_sec"]=clockEstimatedError();
    d["ntp_interval_sec"]=ntpIntervalSec;
    d["wifi_connected"]=WiFi.status()==WL_CONNECTED;
    d["wifi_ip"]=WiFi.localIP().toString();
    d["radio_active"]=last_station>=0 && !radioPaused;
    d["radio_paused"]=radioPaused;
    d["timer_running"]=istimerstarted!=0;
    d["carrier_hz"]=carrierFrequencyHz;
    d["station"]=last_station;
    d["boundary_delay_us"]=radioBoundaryErrorUs;
    d["boundary_delay_worst_us"]=radioBoundaryWorstUs;
    d["missed_second_boundaries"]=radioMissedBoundaries;
    d["bt_window_active"]=btWindowActive;
    d["bt_pair_mode"]=btPairModeActive || btPairRequested;
    d["bt_connection_attempts"]=btConnectionAttempts;
    d["bt_acked_writes"]=btWriteAcknowledgements;
    d["bt_notifications"]=btNotifications;
    d["bt_response_errors"]=btResponseErrors;
    d["bt_delivery_evidence"]=btDeliveryEvidence;
    d["littlefs_total"]=LittleFS.totalBytes();
    d["littlefs_used"]=LittleFS.usedBytes();
    String j; serializeJson(d,j); server.send(200,"application/json",j);
  });

  server.on("/api/bluetooth-pair", HTTP_POST, []() {
    if (full_time_tx) {
      server.send(409, "application/json",
                  "{\"status\":\"error\",\"message\":\"Disable full-time radio transmission before pairing a watch\"}");
      return;
    }
    if (!clockTrusted()) {
      server.send(503, "application/json",
                  "{\"status\":\"error\",\"message\":\"No trusted NTP clock yet. Synchronize NTP first.\"}");
      return;
    }
    if (btBleBusy || btWindowActive || btManualSyncRequested || btPairRequested) {
      server.send(409, "application/json",
                  "{\"status\":\"error\",\"message\":\"Bluetooth is already busy\"}");
      return;
    }
    if (!validBtProtocol(btManualProtocol) || btManualProfile >= BT_WATCH_PROFILE_COUNT) {
      server.send(400, "application/json",
                  "{\"status\":\"error\",\"message\":\"Invalid watch profile or protocol\"}");
      return;
    }

    // Do NOT erase the existing learned address here. Pair mode temporarily
    // bypasses that filter and commit-replaces the binding only after a
    // successful connection/time write.
    btPairRequested = true;
    btLastSyncStatus = String("Pairing Watch ") + (btManualProfile + 1) +
                       ": put the watch into Bluetooth pairing mode";
    server.send(200, "application/json",
                "{\"status\":\"ok\",\"message\":\"Pairing window opened. Put the selected watch into Bluetooth pairing/connection mode.\"}");
  });

  server.on("/api/bluetooth-sync", HTTP_POST, []() {
    if (full_time_tx) {
      server.send(409, "application/json", "{\"status\":\"error\",\"message\":\"Disable full-time radio transmission before a manual Bluetooth sync\"}");
      return;
    }
    if (!clockTrusted()) {
      server.send(503,"application/json","{\"status\":\"error\",\"message\":\"No trusted NTP clock yet. Synchronize NTP first.\"}");return;
    }
    if (btBleBusy || btWindowActive || btManualSyncRequested || btPairRequested) {
      server.send(409, "application/json", "{\"status\":\"error\",\"message\":\"Bluetooth is already busy\"}");
      return;
    }
    btManualSyncRequested = true;
    btLastSyncStatus = String("Waiting for ") + btProtocolName(btManualProtocol);
    server.send(200, "application/json",
                "{\"status\":\"ok\",\"message\":\"Waiting for watch-initiated Bluetooth connection\"}");
  });


  // Request an immediate SNTP client restart from the web interface.
  server.on("/api/ntp-sync", HTTP_POST, []() {
    if (WiFi.status() != WL_CONNECTED) {
      server.send(503, "application/json",
                  "{\"status\":\"error\",\"message\":\"Wi-Fi is not connected\"}");
      return;
    }
    // Restart the SNTP state machine without changing the learned adaptive interval.
    sntp_restart();
    Serial.println("NTP sync requested from web UI");
    server.send(200, "application/json",
                "{\"status\":\"ok\",\"message\":\"NTP synchronization requested\"}");
  });

  webRoutesRegistered=true;
  }
  server.begin(); webServerStarted=true;
}

static const uint8_t INDEX_HTML_GZ[] PROGMEM = {
  0x1f,0x8b,0x08,0x00,0x00,0x00,0x00,0x00,0x02,0xff,0xc5,0x7d,0xd9,0x96,0xdb,0x48,0xb2,0xd8,0xbb,0xbe,
  0x02,0xcd,0x56,0x37,0x88,0x11,0xc8,0x22,0x59,0x64,0x2d,0x64,0x91,0x65,0x49,0x2d,0xdd,0xe9,0xb9,0xad,
  0xc5,0xaa,0xea,0x59,0x8e,0xac,0x53,0x02,0x89,0x04,0x89,0x29,0x10,0x60,0x03,0x60,0xb1,0xaa,0x29,0x9e,
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  0x96,0xce,0x83,0xd1,0xa3,0xff,0x0f,0xec,0xf2,0x6a,0x28,0x59,0x97,0x00,0x00,
};

static void sendIndexPage(void)
{
  server.sendHeader("Content-Encoding", "gzip");
  server.sendHeader("Cache-Control", "no-cache");
  server.send_P(200, PSTR("text/html"), (PGM_P)INDEX_HTML_GZ, sizeof(INDEX_HTML_GZ));
}
//...................................................................
// End of file
// Firmware Version: V3.2.1
